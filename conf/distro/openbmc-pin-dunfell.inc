## meta-delta/meta-agc032a/conf/bblayers.conf.sample
```bitbake
# LAYER_CONF_VERSION is increased each time build/conf/bblayers.conf
# changes incompatibly
LCONF_VERSION = "6"

BBPATH = "${TOPDIR}"
BBFILES ?= ""

BBLAYERS ?= " \
  ##OEROOT##/meta \
  ##OEROOT##/meta-poky \
  ##OEROOT##/meta-yocto-bsp \
  ##OEROOT##/../meta-openembedded/meta-oe \
  ##OEROOT##/../meta-openembedded/meta-networking \
  ##OEROOT##/../meta-openembedded/meta-python \
  ##OEROOT##/../meta-openembedded/meta-perl \
  ##OEROOT##/../../.. \
  ##OEROOT##/../meta-security \
  ##OEROOT##/../meta-security/meta-tpm \
  ##OEROOT##/../../../meta-aspeed \
  ##OEROOT##/../../../meta-facebook \
  ##OEROOT##/../../../meta-facebook/meta-python3 \
  ##OEROOT##/../../../meta-delta \
  ##OEROOT##/../../../meta-delta/meta-agc032a \
  "
BBLAYERS_NON_REMOVABLE ?= " \
  ##OEROOT##/meta \
  ##OEROOT##/meta-yocto \
  "
```

## meta-delta/meta-agc032a/conf/layer.conf
```bitbake
# We have a conf and classes directory, add to BBPATH
BBPATH .= ":${LAYERDIR}"

# We have recipes-* directories, add to BBFILES
BBFILES += "${LAYERDIR}/recipes-*/*/*.bb \
	${LAYERDIR}/recipes-*/*/*.bbappend"

BBFILE_COLLECTIONS += "agc032a"
BBFILE_PATTERN_agc032a = "^${LAYERDIR}/"
BBFILE_PRIORITY_agc032a = "20"
LAYERSERIES_COMPAT_agc032a = "gatesgarth dunfell zeus"
```

## meta-delta/meta-agc032a/conf/local.conf.sample
```bitbake
#
# Local configuration file for building the OpenBMC image.
#

# Machine Selection
MACHINE ??= "agc032a"

# OpenBMC distro settings
DISTRO ?= "openbmc-delta"
```

## meta-delta/meta-agc032a/conf/machine/agc032a.conf
```bitbake
#@TYPE: Machine
#@NAME: AGC032A
#@DESCRIPTION: Machine configuration for AGC032A

require conf/machine/include/ast2520.inc

UBOOT_MACHINE_agc032a = "agc032a_defconfig"
UBOOT_CONFIG_BASE = "fbobmc-ast-g5-tpm2_defconfig"

PREFERRED_VERSION_u-boot = "v2019.04"
PREFERRED_VERSION_u-boot-fw-utils = "v2019.04"
PREFERRED_VERSION_u-boot-fw-utils-cross = "v2019.04"
PREFERRED_VERSION_u-boot-tools = "v2019.04"
PREFERRED_VERSION_u-boot-tools-native = "v2019.04"
PREFERRED_VERSION_nativesdk-u-boot-tools = "v2019.04"

KERNEL_IMAGETYPE = "zImage"

KERNEL_DEVICETREE = "aspeed-bmc-delta-agc032a.dtb"
PREFERRED_VERSION_linux-aspeed = "5.10.%"
PREFERRED_VERSION_libwatchdog = "0.2"
PREFERRED_VERSION_libipmi = "0.2"
PREFERRED_VERSION_ipmid = "0.2"
PREFERRED_VERSION_at93cx6-util = "0.1"
PREFERRED_VERSION_fscd = "0.3"
PREFERRED_VERSION_openbmc-gpio = "0.2"

MACHINE_ESSENTIAL_EXTRA_RDEPENDS += "           \
    kernel-module-i2c-dev-sysfs                 \
    kernel-module-i2c-dev-psu                   \
    kernel-module-cpld                          \
    kernel-module-i2c                           \
    "

SERIAL_CONSOLES += "115200;ttyS4"
EXTRA_IMAGE_FEATURES_append = " image-meta "
FW_ENV_CONFIG_FILE = "fw_env.config.64k"
```

## meta-delta/meta-agc032a/recipes-bsp/u-boot/files/agc032a_defconfig
```kconfig
# Target
CONFIG_TARGET_FB_AST_GEN_5=y
CONFIG_SYS_CONFIG_NAME="agc032a"
CONFIG_DEFAULT_DEVICE_TREE="agc032a"

# ARCH choices
CONFIG_ARM=y
CONFIG_ARCH_ASPEED=y
CONFIG_ASPEED_AST2500=y

# temp
CONFIG_ARCH_AST2500=y


# common configuration
CONFIG_DM_RESET=y
CONFIG_BAUDRATE=115200
CONFIG_NR_DRAM_BANKS=1
CONFIG_SYS_NS16550=y
CONFIG_CMD_IMI=y
CONFIG_OF_LIBFDT=y
CONFIG_OF_CONTROL=y
# CONFIG_OF_EMBED=y use for debug only
CONFIG_OF_SEPARATE=y
CONFIG_FIT=y
CONFIG_FIT_VERBOSE=y
# CONFIG_FIT_SIGNATURE=y
CONFIG_DM=y
CONFIG_DM_I2C=y
CONFIG_CMD_I2C=y
CONFIG_MISC=y
# CONFIG_TPM=y use for TPM support platform
# CONFIG_CMD_TPM=y
CONFIG_TIMER=y
# CONFIG_DISPLAY_CPUINFO is not set

# Migrate to upstream
CONFIG_CLK=y
CONFIG_WDT=y
CONFIG_WDT_ASPEED=y
CONFIG_SYSRESET=y
CONFIG_AST_TIMER=y
CONFIG_SPI=y
CONFIG_DM_SPI=y
CONFIG_SPI_FLASH=y
CONFIG_DM_SPI_FLASH=y
CONFIG_SPI_FLASH_MTD=y
CONFIG_SPI_FLASH_MACRONIX=y
CONFIG_SPI_FLASH_WINBOND=y
CONFIG_CMD_SF=y

CONFIG_DM_ETH=y
CONFIG_FTGMAC100=y
CONFIG_PHY=y
CONFIG_PHYLIB=y
CONFIG_PHY_GIGE=y
CONFIG_PHY_BROADCOM=y
CONFIG_PINCTRL=y
CONFIG_DM_GPIO=y
CONFIG_ASPEED_GPIO=y


# Delta Extra
CONFIG_SYS_TEXT_BASE=0x0
CONFIG_SPI_BOOT=y
CONFIG_HUSH_PARSER=y
CONFIG_NETDEVICES=y
CONFIG_DEBUG_UART=y
CONFIG_DEBUG_UART_BASE=0x1E784000
CONFIG_DEBUG_UART_CLOCK=24000000
CONFIG_BOOTDELAY=5
CONFIG_SYS_PROMPT="agc032a-boot=> "
CONFIG_ASPEED_ENABLE_DUAL_BOOT_WATCHDOG=y

# "image-meta" partition is introduced in IMG_LAYOUT_V1, and meanwhile
# u-boot-env size is decreased to 64KB.
CONFIG_FBOBMC_IMG_LAYOUT_VER=1

# Enable write default environment
CONFIG_ASPEED_WRITE_DEFAULT_ENV=y

# Disabled commands (save space)
CONFIG_CMD_IMLS=n
CONFIG_CMD_FDT=y
CONFIG_CMD_ELF=n
CONFIG_CMD_XIMG=n
# CONFIG_CMD_NET=n
CONFIG_EFI_LOADER=y
CONFIG_CMD_FPGA=n
CONFIG_CMD_SETEXPR=n

# debug
CONFIG_LOGLEVEL=7
```

## meta-evb/meta-evb-nuvoton/meta-evb-npcm845/conf/machine/evb-npcm845.conf
```bitbake
#@TYPE: Machine
#@NAME: evb-npcm845
#@DESCRIPTION: NPCM845 EVB FB-OpenBMC

MACHINE = "evb-npcm845"
require conf/machine/include/npcm8xx.inc

IGPS_MACHINE = "EB"
DEVICE_GEN = "A1"

UBOOT_MACHINE = "ArbelEVB_defconfig"
UBOOT_DEVICETREE = "nuvoton-npcm845-evb"
UBOOT_SUFFIX ?= "bin"
EXTRA_IMAGEDEPENDS += "u-boot-nuvoton"

FLASH_SIZE = "65536"
FLASH_UBOOT_OFFSET:flash-65536 = "0"
FLASH_KERNEL_OFFSET:flash-65536 = "2048"
FLASH_ROFS_OFFSET:flash-65536 = "10240"
FLASH_RWFS_OFFSET:flash-65536 = "46080"

KDEVICETREE = "nuvoton-npcm845-evb.dtb"
KERNEL_DEVICETREE = "nuvoton/${KDEVICETREE}"
```

## meta-facebook/conf/distro/include/fb-base.inc
```bitbake
include conf/distro/openbmc-yocto-${DISTRO_CODENAME}.inc
require conf/distro/include/fb/network.inc
require conf/distro/include/fb/packaging.inc
require conf/distro/include/fb/parallel.inc
require conf/distro/include/fb/sstate.inc
require conf/distro/include/fb/versioning.inc

DEFAULT_TIMEZONE ?= "America/Los_Angeles"

# By default disable interactive patch resolution (tasks will just fail instead):
PATCHRESOLVE = "noop"

def yocto_halt_taskname(d):
    distro = d.getVar('DISTRO_CODENAME', True)
    if distro in [ 'rocko', 'dunfell' ]:
        return "ABORT"
    return "HALT"

# Disk Space Monitoring during the build
#   This comes from the Yocto default in their local.inc.sample.
BB_DISKMON_DIRS ??= "\
    STOPTASKS,${TMPDIR},1G,100K \
    STOPTASKS,${DL_DIR},1G,100K \
    STOPTASKS,${SSTATE_DIR},1G,100K \
    STOPTASKS,/tmp,100M,100K \
    ${@yocto_halt_taskname(d)},${TMPDIR},100M,1K \
    ${@yocto_halt_taskname(d)},${DL_DIR},100M,1K \
    ${@yocto_halt_taskname(d)},${SSTATE_DIR},100M,1K \
    ${@yocto_halt_taskname(d)},/tmp,10M,1K"
```
