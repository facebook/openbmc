## meta-facebook/conf/distro/openbmc-fb-dunfell.conf
```bitbake
DISTRO_CODENAME="dunfell"
UNPACKDIR ??= "${WORKDIR}"
TCLIBCAPPEND = ""
# Wrynose renamed DISTRO_FEATURES_BACKFILL_CONSIDERED
DISTRO_FEATURES_BACKFILL_CONSIDERED = "${DISTRO_FEATURES_OPTED_OUT}"
require conf/distro/include/fb-openbmc.inc
```

## meta-facebook/conf/distro/openbmc-fb-rocko.conf
```bitbake
DISTRO_CODENAME="rocko"
BB_SIGNATURE_HANDLER ?= "OEBasicHash"
UNPACKDIR ??= "${WORKDIR}"
TCLIBCAPPEND = ""
# Wrynose renamed DISTRO_FEATURES_BACKFILL_CONSIDERED
DISTRO_FEATURES_BACKFILL_CONSIDERED = "${DISTRO_FEATURES_OPTED_OUT}"
require conf/distro/include/fb-openbmc.inc
```

## meta-facebook/meta-fbdarwin/conf/machine/fbdarwin.conf
```bitbake
#@TYPE: Machine
#@NAME: FBDarwin
#@DESCRIPTION: Machine configuration for Facebook FBDarwin

require conf/machine/fboss-lite.inc
require conf/machine/include/runqemu.inc

UBOOT_MACHINE:fbdarwin = "facebook-fbdarwin_defconfig"

#
# Kernel version.
#
KERNEL_DEVICETREE = "aspeed/aspeed-bmc-facebook-darwin.dtb"
PREFERRED_VERSION_linux-aspeed = "6.18.%"

#
# NOTE: fbdarwin still use the legacy EEPROM format although it's BMC-lite
# FBOSS switch.
#
PREFERRED_VERSION_wedge-eeprom = "0.2"
PREFERRED_VERSION_libwedge-eeprom = "0.2"

MACHINE_FEATURES += "emmc emmc-ext4"
```

## meta-facebook/meta-rainiera7/conf/machine/rainiera7-upstream-overrides.conf
```bitbake
RAINIERA7_ASSUMED_PROVIDERS = ""
RAINIERA7_IMAGE_FSTYPES_REMOVE = ""

PREFERRED_PROVIDER_u-boot-fw-utils = "libubootenv"

PREFERRED_PROVIDER_virtual/kernel = "linux-aspeed"

PREFERRED_VERSION_u-boot-aspeed-sdk = "v2023.10%"

KERNEL_DEVICETREE = "aspeed/${KMACHINE}-bmc-facebook-${MACHINE}.dtb"
UBOOT_DEVICETREE = "ast2700-facebook"

PREFERRED_PROVIDER_virtual/bootmcu = "zephyr-aspeed-bootmcu"

ZEPHYR_TOOLCHAIN_VARIANT = "zephyr"
PREFERRED_VERSION_zephyr-sdk-native = "0.16.9"
PREFERRED_VERSION_zephyr-kernel ??= "3.7.0"
```
