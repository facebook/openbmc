## meta-facebook/meta-cloudripper/conf/layer.conf
```bitbake
# We have a conf and classes directory, add to BBPATH
BBPATH .= ":${LAYERDIR}"

# We have recipes-* directories, add to BBFILES
BBFILES += "${LAYERDIR}/recipes-*/*/*.bb \
	${LAYERDIR}/recipes-*/*/*.bbappend"

BBFILE_COLLECTIONS += "cloudripper"
BBFILE_PATTERN_cloudripper = "^${LAYERDIR}/"
BBFILE_PRIORITY_cloudripper = "20"

LAYERSERIES_COMPAT_cloudripper = "mickledore kirkstone dunfell"

#Will enable the following once we have all the needed packages ready
DISTRO_FEATURES:append = " systemd"
VIRTUAL-RUNTIME_init_manager = "systemd"
DISTRO_FEATURES_BACKFILL_CONSIDERED += "sysvinit"
VIRTUAL-RUNTIME_initscripts = "systemd-compat-units"
```

## meta-facebook/meta-cloudripper/conf/local.conf.sample
```bitbake
#
# Local configuration file for building the OpenBMC image.
#

# Machine Selection
MACHINE ??= "cloudripper"

# OpenBMC distro settings
DISTRO ?= "openbmc-fb"
```

## meta-facebook/meta-cloudripper/conf/machine/cloudripper.conf
```bitbake
#@TYPE: Machine
#@NAME: Cloudripper
#@DESCRIPTION: Machine configuration for Facebook Cloudripper

require conf/machine/include/ast2620.inc

KERNEL_IMAGETYPE = "zImage"
UBOOT_MACHINE:cloudripper = "facebook-cloudripper_defconfig"

KERNEL_DEVICETREE = "aspeed-bmc-facebook-cloudripper.dtb"
PREFERRED_VERSION_linux-aspeed = "5.10.%"

PREFERRED_VERSION_u-boot = "v2019.04"
PREFERRED_VERSION_u-boot-tools = "v2019.04"
PREFERRED_VERSION_u-boot-tools-native = "v2019.04"
PREFERRED_VERSION_nativesdk-u-boot-tools = "v2019.04"
PREFERRED_VERSION_u-boot-fw-utils = "v2019.04"
PREFERRED_VERSION_u-boot-fw-utils-cross = "v2019.04"

PREFERRED_VERSION_libwatchdog = "0.2"
PREFERRED_VERSION_libipmi = "0.2"
PREFERRED_VERSION_ipmid = "0.2"
PREFERRED_VERSION_libbic = "0.2"
PREFERRED_VERSION_bic-util = "0.2"
PREFERRED_VERSION_rest-api = "0.1"
PREFERRED_VERSION_fw-util = "0.2"

require conf/machine/include/tpm2.inc

MACHINE_FEATURES += "emmc"
MACHINE_ESSENTIAL_EXTRA_RDEPENDS += "           \
    kernel-module-i2c-dev-sysfs                 \
    kernel-module-i2c-dev-domfpga               \
    kernel-module-i2c-dev-psu                   \
    kernel-module-cpld                          \
    "
MACHINE_FEATURES += "emmc emmc-ext4"
EXTRA_IMAGE_FEATURES:append = " image-meta"
FW_ENV_CONFIG_FILE = "fw_env.config.64k"
```

## meta-facebook/meta-cmm/conf/layer.conf
```bitbake
# We have a conf and classes directory, add to BBPATH
BBPATH .= ":${LAYERDIR}"

# We have recipes-* directories, add to BBFILES
BBFILES += "${LAYERDIR}/recipes-*/*/*.bb \
	${LAYERDIR}/recipes-*/*/*.bbappend"

BBFILE_COLLECTIONS += "cmm"
BBFILE_PATTERN_cmm = "^${LAYERDIR}/"
BBFILE_PRIORITY_cmm = "20"

LAYERSERIES_COMPAT_cmm = "mickledore langdale kirkstone dunfell"
```

## meta-facebook/meta-cmm/conf/machine/cmm.conf
```bitbake
#@TYPE: Machine
#@NAME: Galaxy CMM
#@DESCRIPTION: Machine configuration for Facebook Galaxy CMM

require conf/machine/include/ast2520.inc
require conf/machine/include/fb-fboss.inc

KERNEL_IMAGETYPE = "zImage"
UBOOT_MACHINE:cmm = "fbcmm_config"

#
# Kernel version.
#
KERNEL_DEVICETREE = "aspeed-bmc-facebook-cmm.dtb"
PREFERRED_VERSION_linux-aspeed = "6.1.%"

#
# U-boot version.
#
PREFERRED_VERSION_u-boot = "v2019.04%"
PREFERRED_VERSION_u-boot-tools = "v2019.04%"
PREFERRED_VERSION_u-boot-tools-native = "v2019.04%"
PREFERRED_VERSION_nativesdk-u-boot-tools = "v2019.04%"
PREFERRED_VERSION_u-boot-fw-utils = "v2019.04%"
PREFERRED_VERSION_u-boot-fw-utils-cross = "v2019.04%"

#
# Preferred version of user space packages.
#
PREFERRED_VERSION_rest-api = "0.1"
PREFERRED_VERSION_at93cx6-util = "0.1"
PREFERRED_VERSION_bcm5396-util = "0.1"

MACHINE_ESSENTIAL_EXTRA_RDEPENDS += "           \
    kernel-module-cpld                          \
    "

MACHINE_FEATURES += "emmc emmc-ext4"
```

## meta-facebook/meta-elbert/conf/layer.conf
```bitbake
# We have a conf and classes directory, add to BBPATH
BBPATH .= ":${LAYERDIR}"

# We have recipes-* directories, add to BBFILES
BBFILES += "${LAYERDIR}/recipes-*/*/*.bb \
	          ${LAYERDIR}/recipes-*/*/*.bbappend \
            ${LAYERDIR}/facebook/recipes-*/*/*.bb \
	          ${LAYERDIR}/facebook/recipes-*/*/*.bbappend"

DISTRO_FEATURES:append = " systemd usrmerge"
VIRTUAL-RUNTIME_init_manager = "systemd"
DISTRO_FEATURES_BACKFILL_CONSIDERED += "sysvinit"
VIRTUAL-RUNTIME_initscripts = "systemd-compat-units"

BBFILE_COLLECTIONS += "elbert"
BBFILE_PATTERN_elbert = "^${LAYERDIR}/"
BBFILE_PRIORITY_elbert = "20"

LAYERSERIES_COMPAT_elbert = "scarthgap nanbield kirkstone dunfell"
```

## meta-facebook/meta-elbert/conf/local.conf.sample
```bitbake
#
# Local configuration file for building the OpenBMC image.
#

# Machine Selection
MACHINE ??= "elbert"

# OpenBMC distro settings
DISTRO ?= "openbmc-fb"
```

## meta-facebook/meta-elbert/conf/machine/elbert.conf
```bitbake
#@TYPE: Machine
#@NAME: Elbert
#@DESCRIPTION: Machine configuration for Facebook Elbert

require conf/machine/include/ast2620.inc

KERNEL_IMAGETYPE = "zImage"
UBOOT_MACHINE_elbert = "facebook-elbert_defconfig"
KERNEL_DEVICETREE = "aspeed-bmc-facebook-elbert.dtb"

PREFERRED_VERSION_linux-aspeed = "5.6.14"

PREFERRED_VERSION_u-boot = "v2019.04"
PREFERRED_VERSION_u-boot-tools = "v2019.04"
PREFERRED_VERSION_u-boot-tools-native = "v2019.04"
PREFERRED_VERSION_nativesdk-u-boot-tools = "v2019.04"
PREFERRED_VERSION_u-boot-fw-utils = "v2019.04"
PREFERRED_VERSION_u-boot-fw-utils-cross = "v2019.04"

# configuration for preferred version of packages
PREFERRED_VERSION_libwatchdog = "0.2"
PREFERRED_VERSION_rest-api = "0.1"
PREFERRED_VERSION_fscd = "0.3"

MACHINE_FEATURES += "tpm2"
MACHINE_FEATURES += "emmc"
MACHINE_FEATURES += "pfr"

# kernel-module-cpld
MACHINE_ESSENTIAL_EXTRA_RDEPENDS += "           \
    kernel-module-i2c-dev-sysfs                 \
    kernel-module-cpld                          \
   "

EXTRA_IMAGE_FEATURES_append = " image-meta"
FW_ENV_CONFIG_FILE = "fw_env.config.64k"
```

## meta-facebook/meta-elbert/conf/machine/elbertvboot.conf
```bitbake
#@TYPE: Machine
#@NAME: Elbert
#@DESCRIPTION: Machine configuration for Facebook Elbert

require conf/machine/include/ast2620.inc

KERNEL_IMAGETYPE = "zImage"
UBOOT_MACHINE:elbertvboot = "facebook-elbertvboot_defconfig"
UBOOT_CONFIG_BASE = "fbobmc-ast-g6_defconfig"

KERNEL_DEVICETREE = "aspeed-bmc-facebook-elbertvboot.dtb"

PREFERRED_VERSION_linux-aspeed = "5.6.19"

PREFERRED_VERSION_u-boot = "v2019.04"
PREFERRED_VERSION_u-boot-tools = "v2019.04"
PREFERRED_VERSION_u-boot-tools-native = "v2019.04"
PREFERRED_VERSION_nativesdk-u-boot-tools = "v2019.04"
PREFERRED_VERSION_u-boot-fw-utils = "v2019.04"
PREFERRED_VERSION_u-boot-fw-utils-cross = "v2019.04"

# configuration for preferred version of packages
PREFERRED_VERSION_libwatchdog = "0.2"
PREFERRED_VERSION_rest-api = "0.1"
PREFERRED_VERSION_fscd = "0.3"
PREFERRED_VERSION_libpal = "0.2"
PREFERRED_VERSION_libipmi = "0.2"
PREFERRED_VERSION_ipmid = "0.2"
PREFERRED_VERSION_openbmc-gpio = "0.2"
PREFERRED_VERSION_kcsd = "0.2"

require conf/machine/include/tpm2.inc

MACHINE_FEATURES += "emmc emmc-ext4"

# kernel-module-cpld
MACHINE_ESSENTIAL_EXTRA_RDEPENDS += "           \
    kernel-module-i2c-dev-sysfs                 \
    kernel-module-cpld                          \
    kernel-module-i2c                           \
   "

EXTRA_IMAGE_FEATURES:append = " image-meta verified-boot"
FW_ENV_CONFIG_FILE = "fw_env.config.64k"
```

## meta-facebook/meta-fbal/conf/layer.conf
```bitbake
# We have a conf and classes directory, add to BBPATH
BBPATH .= ":${LAYERDIR}"

# We have recipes-* directories, add to BBFILES
BBFILES += "${LAYERDIR}/recipes-*/*/*.bb \
	${LAYERDIR}/recipes-*/*/*.bbappend"

BBFILE_COLLECTIONS += "angelslanding"
BBFILE_PATTERN_angelslanding = "^${LAYERDIR}/"
BBFILE_PRIORITY_angelslanding = "20"

LAYERSERIES_COMPAT_angelslanding = "kirkstone honister dunfell"
```

## meta-facebook/meta-fbal/conf/machine/angelslanding.conf
```bitbake
#@TYPE: Machine
#@NAME: Angel's Landing
#@DESCRIPTION: Machine configuration for Facebook FBAL

require conf/machine/include/ast2520.inc

UBOOT_MACHINE:angelslanding = "fbal_defconfig"
UBOOT_CONFIG_BASE = "fbobmc-ast-g5-tpm2_defconfig"
KERNEL_IMAGETYPE = "zImage"
KERNEL_DEVICETREE = "aspeed-bmc-facebook-angelslanding.dtb"

# configuration for preferred version of packages
PREFERRED_VERSION_u-boot = "v2019.04"
PREFERRED_VERSION_u-boot-fw-utils = "v2019.04"
PREFERRED_VERSION_u-boot-fw-utils-cross = "v2019.04"
PREFERRED_VERSION_u-boot-tools = "v2019.04"
PREFERRED_VERSION_u-boot-tools-native = "v2019.04"
PREFERRED_VERSION_nativesdk-u-boot-tools = "v2019.04"

PREFERRED_VERSION_linux-aspeed = "5.0.3"
PREFERRED_VERSION_libwatchdog = "0.2"
PREFERRED_VERSION_bios-util = "0.2"
PREFERRED_VERSION_asd = "1.4.3"

require conf/machine/include/ncsi.inc

MACHINE_FEATURES += "tpm2"
MACHINE_FEATURES += "compute-rest"

EXTRA_IMAGE_FEATURES:append = " verified-boot image-meta "
FW_ENV_CONFIG_FILE = "fw_env.config.64k"
```

## meta-facebook/meta-fbdarwin/conf/local.conf.sample
```bitbake
#
# Local configuration file for building the OpenBMC image.
#

# Machine Selection
MACHINE ??= "fbdarwin"

# MACHINE ??= "fbdarwin-fbvboot"

# OpenBMC distro settings
DISTRO ?= "openbmc-fb"
```

## meta-facebook/meta-fbep/conf/layer.conf
```bitbake
# We have a conf and classes directory, add to BBPATH
BBPATH .= ":${LAYERDIR}"

# We have recipes-* directories, add to BBFILES
BBFILES += "${LAYERDIR}/recipes-*/*/*.bb \
	${LAYERDIR}/recipes-*/*/*.bbappend"

BBFILE_COLLECTIONS += "emeraldpools"
BBFILE_PATTERN_emeraldpools = "^${LAYERDIR}/"
BBFILE_PRIORITY_emeraldpools = "20"

LAYERSERIES_COMPAT_emeraldpools = "mickledore kirkstone dunfell"
```

## meta-facebook/meta-fbep/conf/machine/emeraldpools.conf
```bitbake
#@TYPE: Machine
#@NAME: Emerald Pools
#@DESCRIPTION: Machine configuration for Facebook Open Accelerator Module

require conf/machine/include/ast2520.inc

UBOOT_MACHINE_emeraldpools = "fbep_config"
KERNEL_IMAGETYPE = "zImage"
KERNEL_DEVICETREE = "aspeed-bmc-facebook-emeraldpools.dtb"

# configuration for preferred version of packages
PREFERRED_VERSION_u-boot = "v2016.07"
PREFERRED_VERSION_u-boot-mkimage = "v2016.07"
PREFERRED_VERSION_u-boot-fw-utils = "v2016.07"

PREFERRED_VERSION_bios-util = "0.2"
PREFERRED_VERSION_at93cx6-util = "0.1"
PREFERRED_VERSION_libwatchdog = "0.1"
PREFERRED_VERSION_linux-aspeed = "5.0.3"
PREFERRED_VERSION_libwatchdog = "0.2"
```

## meta-facebook/meta-fboss-lite/conf/machine/fboss-lite.inc
```bitbake
#@TYPE: Machine
#@NAME: FBOSS-Lite
#@DESCRIPTION: Machine configuration for Facebook FBOSS-Lite

require conf/machine/include/ast2620.inc
require conf/machine/include/fb-fboss.inc
require conf/machine/include/mtd-ubifs.inc
require conf/machine/include/tpm2.inc

KERNEL_IMAGETYPE = "zImage"
UBOOT_CONFIG_BASE = "fbobmc-ast-g6_defconfig"

PREFERRED_VERSION_u-boot = "v2019.04%"
PREFERRED_VERSION_u-boot-tools = "v2019.04%"
PREFERRED_VERSION_u-boot-tools-native = "v2019.04%"
PREFERRED_VERSION_nativesdk-u-boot-tools = "v2019.04%"
PREFERRED_VERSION_u-boot-fw-utils = "v2019.04%"
PREFERRED_VERSION_u-boot-fw-utils-cross = "v2019.04%"

# Select wedge-eeprom-0.2 to support Meta EEPROM format v4.
PREFERRED_VERSION_wedge-eeprom = "0.2"
PREFERRED_VERSION_libwedge-eeprom = "0.2"

MACHINE_FEATURES += "emmc emmc-ext4"

MACHINE_ESSENTIAL_EXTRA_RDEPENDS += "kernel-module-i2c-dev-sysfs"

EXTRA_IMAGE_FEATURES:append = " image-meta"
FW_ENV_CONFIG_FILE = "fw_env.config.64k"
```

## meta-facebook/meta-fbsp/conf/layer.conf
```bitbake
# We have a conf and classes directory, add to BBPATH
BBPATH .= ":${LAYERDIR}"

# We have recipes-* directories, add to BBFILES
BBFILES += "${LAYERDIR}/recipes-*/*/*.bb \
	${LAYERDIR}/recipes-*/*/*.bbappend"

BBFILE_COLLECTIONS += "sonorapass"
BBFILE_PATTERN_sonorapass = "^${LAYERDIR}/"
BBFILE_PRIORITY_sonorapass = "20"

LAYERSERIES_COMPAT_sonorapass = "mickledore kirkstone dunfell"
```

## meta-facebook/meta-fbsp/conf/machine/sonorapass.conf
```bitbake
#@TYPE: Machine
#@NAME: Sonora Pass
#@DESCRIPTION: Machine configuration for Facebook 2S Server Platform

require conf/machine/include/ast2520.inc

UBOOT_MACHINE:sonorapass = "fbsp_config"
KERNEL_IMAGETYPE = "zImage"
KERNEL_DEVICETREE = "aspeed-bmc-facebook-sonorapass.dtb"

# configuration for preferred version of packages
PREFERRED_VERSION_u-boot = "v2019.01"
PREFERRED_VERSION_u-boot-tools = "v2019.01"
PREFERRED_VERSION_u-boot-tools-native = "v2019.01"
PREFERRED_VERSION_nativesdk-u-boot-tools = "v2019.01"
PREFERRED_VERSION_u-boot-fw-utils = "v2019.01"
PREFERRED_VERSION_u-boot-fw-utils-cross = "v2019.01"

PREFERRED_VERSION_bios-util = "0.2"
PREFERRED_VERSION_at93cx6-util = "0.1"
PREFERRED_VERSION_libwatchdog = "0.1"
PREFERRED_VERSION_linux-aspeed = "5.0.3"
PREFERRED_VERSION_libwatchdog = "0.2"

require conf/machine/include/fb-compute.inc
require conf/machine/include/ncsi.inc
require conf/machine/include/tpm2.inc

MACHINE_FEATURES += "emmc"
MACHINE_FEATURES += "pfr"
```

## meta-facebook/meta-fbtp/conf/layer.conf
```bitbake
# We have a conf and classes directory, add to BBPATH
BBPATH .= ":${LAYERDIR}"

# We have recipes-* directories, add to BBFILES
BBFILES += "${LAYERDIR}/recipes-*/*/*.bb \
	${LAYERDIR}/recipes-*/*/*.bbappend"

BBFILE_COLLECTIONS += "fbtp"
BBFILE_PATTERN_fbtp = "^${LAYERDIR}/"
BBFILE_PRIORITY_fbtp = "20"

LAYERSERIES_COMPAT_fbtp = "mickledore kirkstone dunfell rocko"
```

## meta-facebook/meta-fbtp/conf/local.conf.sample
```bitbake
#
# Local configuration file for building the OpenBMC image.
#

# Machine Selection
MACHINE ??= "fbtp"

# OpenBMC distro settings
DISTRO ?= "openbmc-fb"

# The following will enable a build capable of verified-boot.
# Images and the resultant flash are always built as a FIT (firmware image).
# When verified-boot is enabled, the u-boot firmware attempts to be built as
# a ROM part and upgradable part using the SPL options.
#
# A public key must be configured, which will be built into the resultant ROM.
# During normal builds the ROM is not needed since the assumption is you have
# burned it after the first/initial build.
#
# Subsequent builds will need to be signed, thus an on-line private key is used.
# Development builds should use a key: openbmc-dev since the on-line build key
# is assumed to NOT be available within the burned-in ROM. A build host that
# have privileged access to a signed key can override within local.
#
# EXTRA_IMAGE_FEATURES += " verified-boot verified-boot-sign "
# VERIFIED_BOOT_KEYNAME = "openbmc-dev"
```

## meta-facebook/meta-fbtp/conf/machine/fbtp-next.conf
```bitbake
#@TYPE: Machine
#@NAME: FBTP
#@DESCRIPTION: Machine configuration for Facebook FBTP

UBOOT_MACHINE:fbtp-next = "fbtp_config"

PREFERRED_VERSION_u-boot = "v2019.01"
PREFERRED_VERSION_u-boot-tools = "v2019.01"
PREFERRED_VERSION_u-boot-tools-native = "v2019.01"
PREFERRED_VERSION_nativesdk-u-boot-tools = "v2019.01"
PREFERRED_VERSION_u-boot-fw-utils = "v2019.01"
PREFERRED_VERSION_u-boot-fw-utils-cross = "v2019.01"
PREFERRED_VERSION_bios-util = "0.2"
PREFERRED_VERSION_at93cx6-util = "0.1"

KERNEL_DEVICETREE = "aspeed-bmc-facebook-tiogapass.dtb"
PREFERRED_VERSION_linux-aspeed = "5.0.3"
PREFERRED_VERSION_libwatchdog = "0.2"

KERNEL_IMAGETYPE = "zImage"

require conf/machine/include/ast2520.inc
require conf/distro/openbmc-pin-rocko.inc

require conf/machine/include/fb-compute.inc
require conf/machine/include/tpm1.inc
```
