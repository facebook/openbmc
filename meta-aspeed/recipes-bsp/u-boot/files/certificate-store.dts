/*
 * Copyright 2016-present Facebook. All Rights Reserved.
 *
 * This program is free software; you can redistribute it and/or modify
 * it under the terms of the GNU General Public License as published by
 * the Free Software Foundation; either version 2 of the License, or
 * (at your option) any later version.
 *
 * This program is distributed in the hope that it will be useful,
 * but WITHOUT ANY WARRANTY; without even the implied warranty of
 * MERCHANTABILITY or FITNESS FOR A PARTICULAR PURPOSE.  See the
 * GNU General Public License for more details.
 *
 * You should have received a copy of the GNU General Public License
 * along with this program; if not, write to the Free Software
 * Foundation, Inc., 675 Mass Ave, Cambridge, MA 02139, USA.
 */

/*
 * Please use the FIT-CS project on GitHub:
 *   https://github.com/theopolis/fit-certificate-store
 *
 * This can generate a Certificate Store from a Public RSA Key.
 * Please use CERTIFICATE_STORE_SOURCE to override the source location.
 *
 * This device tree source file is compiled and used within U-Boot's SPL (ROM)
 * as the verified-boot platform key. It is possible to install multiple keys
 * into the ROM by including multiple keys here.
 */

/dts-v1/;

/ {
	signature {

		key-fbkek1 {
			required = "image";
			algo = "sha256,rsa4096";
			rsa,r-squared = <0x6e6dd6e7 0x4e3f2508 0xe818f5d4 0x2bbf51d4 0xfa912ab6 0x1cd72d3f 0xd5cddf6c 0x165b606a 0x5d765b70 0x31473cf5 0xecf5b63d 0xba5f2c95 0x3091ab95 0x1525eb45 0x6dcb5fb1 0x93da6a60 0x17fe2725 0xb3b67e2d 0x8aebf334 0x3a36290e 0x7278a1a7 0x350b046f 0xe32dde6a 0xa05a425e 0xcf8d95fc 0xe57cd2b8 0x61beddfc 0xc9b78091 0x84676dbf 0x525541db 0xe7194b42 0x7e0dd502 0x121fe8d9 0x951edfb6 0x2c8cc2a1 0x98ce0118 0x7db38f8 0x190a710f 0x1ce69f9a 0xaa411a2d 0xa0ad3f22 0xcf637be3 0x252f1469 0x69117861 0x8ce7a0e1 0x3363fa41 0xb4fb347e 0x33fdcc81 0xe3dbe87e 0x4db78db5 0x52d20cae 0x4fe05c81 0x539d0837 0xb8613c93 0x71df61f3 0x6790f926 0xdd40798a 0xf6f0f1ee 0x7ff6818a 0xdd17c076 0x8576cc9e 0xc83659b 0x9eaf44a3 0x836f42ec 0x9eb29fac 0x9d3e1e6f 0x996d5aef 0xa1f0ab4d 0x39a44a4f 0xdbe6c319 0x7e524b27 0x8ac9d090 0xa0c48e37 0xcd2ea92f 0x4db9d2b 0x76aa6e2d 0x42c09b8a 0x40b121af 0x685fa8a1 0x2c44c63f 0x2147ab66 0xdc1f8dc4 0xc37ca9ae 0xcd3221c0 0x2d68602 0x2ab6bfba 0x59d7131b 0xa82a1e76 0xe5e335dd 0x67b44b4c 0x6b5920bd 0x8cfb0fc3 0xd612fb19 0x6cd4b284 0x576af5de 0xb7d4d338 0x2e87eafb 0xcb1379f5 0x17579a9d 0xad4dd55a 0xbe72c400 0xdac27fca 0xd0688a4a 0xdb8cb712 0xa2dc7a9e 0xe108d4eb 0xd4681040 0x8fda40b 0x6a4f8265 0x2689b4b1 0xfe9409e6 0xbb42b154 0x722f10b8 0x2b7140bf 0xdc038dfb 0x7c02c7dc 0xbd8a7b3b 0x880e7415 0x6aa6e9f8 0x264ff3f9 0xbd41bdf2 0xdf337869 0x3bccd6d 0x5da23537 0x701ed884 0x4c94aa04 0x726b62f8 0x63483f4c>;
			rsa,modulus = <0xba34b6e4 0x7cba84c2 0x5f13c5a6 0xd224cab5 0xda2d4997 0xaab5a107 0xf4069a4b 0xa63eb03a 0x9a39c9ba 0x715c36de 0x333ca3dd 0x9b62de98 0x6240824e 0x9dfb20ef 0xe771b86c 0xdc938a70 0x26555683 0x7d4521ac 0xe52a5e38 0xdd681498 0xde279b39 0x34806613 0x83794989 0x8c886058 0x34c110c7 0xb65cb1d2 0x70eceda0 0xe1654d7d 0xe1cac337 0xa5a662d4 0xd7032ba4 0x42389a0f 0x497b1249 0x7e37f3fd 0xba67cadb 0x79a14df8 0x1351c366 0x2b85a91d 0x5159fd62 0x1367765a 0x8e3e890c 0xd1902bc3 0x15cc987f 0x7373136c 0x59a25cc7 0x98d4f11f 0x867d8b25 0x6cd95372 0xc42a1b98 0xf78137c8 0xda80e82e 0x52f9d3f 0xecea29e5 0xd66c6ba7 0xb6975fc8 0xf35259e6 0x32818e22 0x5604c25d 0x7f613c66 0xa0eef1d0 0x316bb95a 0xcdb50360 0xcb24e1da 0xa6a70192 0x9dc5ac87 0xc82423bf 0xa3ca64dd 0xe8c602bd 0x14f98586 0xd1bf413 0x8eca120e 0x6f023614 0x1d21b493 0xe4ac50e8 0xc38f7e84 0xc1bbf213 0x7b859d80 0xeeddf31b 0xef107647 0x53d61b69 0x9d79f16e 0xe090cdd 0x2e274331 0xeff4d91e 0xb9fff795 0x57a5df1f 0x3fb07b46 0xe4ebdce0 0xb3115d1e 0xdf0e4abb 0x93951b0d 0x92d57abf 0x3a038890 0xef610a96 0xa11bdab4 0x90a70b2c 0xb9a946a8 0x3bc3b6d3 0x3db35d9c 0xce6d5cfd 0x84397078 0x7acf12fe 0x503ea5cf 0xf15d4bc3 0xa18aeaf7 0x1ad16d04 0x71649058 0xac1aa923 0x6aa3384d 0x21258013 0x8ba070fd 0xc0c79079 0x51a43a14 0x29d506ca 0xa1eb6d09 0x67be5bc2 0xbeac43d 0x9d1a2a02 0xc40993cf 0x98d5ac19 0x935a1a1d 0xb2e7f346 0x35bd3b70 0xc57341a2 0xe528796f 0x9c7b55be 0x323c382c 0x561eea21>;
			rsa,exponent = <0x0 0x10001>;
			rsa,n0-inverse = <0xdee8e61f>;
			rsa,num-bits = <0x1000>;
			key-name-hint = "fbkek1";
		};

		key-fbkek2 {
			required = "image";
			algo = "sha256,rsa4096";
			rsa,r-squared = <0x60065f32 0xeb2c94dd 0x9a11d3c7 0xa9ca8bdb 0x596363e9 0x56aabfe4 0xb9c2521f 0x26cf7465 0xec22260b 0xda2df4e8 0x2d5d0548 0x18e9e53 0xb544044b 0x3b83d672 0xd7b284f3 0xaffd73bc 0x479fccf5 0xc73b53d3 0xe7dc4d03 0x9e913519 0x5b1264b7 0x42a7b6a6 0x2916d30 0xb535e053 0xf221c3a0 0x2399e0b3 0xbd203068 0x423fabbb 0x2e240a08 0xfa708183 0xf41863e4 0xa3267689 0x6285e970 0xb171631d 0x1e08f12f 0xf507c845 0x2b801c2c 0x5bb9f5bf 0x2ae565b0 0xef5b1750 0xa3c6764a 0xd65616b9 0x2df9e9f1 0x8e54b96f 0x3d9c91fc 0xf728854a 0x955e2cf0 0x1f7bedb6 0x5d37b17d 0x81902cc4 0x916dd79b 0x2d9e31c5 0xee411eb9 0x3fa2d422 0xe96ca714 0x46f34bb6 0xffd7ed35 0x93d2c70f 0xaf3121a4 0xae7d51a 0x1bd7e4fd 0x93687de1 0xb5d993f4 0x270df926 0x3b052ede 0x8dc9317c 0xf7bf1795 0xfb9ca904 0x87709eae 0xeaab339 0x22b1dd7 0x88ee6737 0xc1785442 0x52e8c955 0x7825f300 0x76474e4a 0x49273e31 0x8f851ffa 0xf6e90482 0xfae37638 0xeaefab99 0x91f227ca 0xe3e8b64a 0x2fa11188 0xe8c35c4 0x676e2334 0x5f75d2f9 0xdef4f83c 0x1e850047 0x46a18f8d 0xd2326505 0xb67aaac2 0x49c93866 0x2bdac399 0x5f9f68f1 0xf1dd855a 0x55a4532b 0x8b572b14 0x73468fd5 0x511a0b73 0xd3afc9d7 0xe6625fae 0x7ca8c7c8 0x9a21e061 0x22d75fbc 0x9c366bed 0x6131cac2 0x177ae5c1 0x10249adb 0x15b8db23 0x2bb87f91 0xa0b98c02 0x7c8cba41 0x9eeb047e 0x7456e899 0x743dbc31 0x9f746f3d 0xc70691e2 0x153209a5 0xa3097ec2 0x61738118 0xe4bc6f32 0xbf68c9f 0x168b97fb 0x34924fa8 0x53e541d 0x61a77ea1 0x17be51e>;
			rsa,modulus = <0xef6a7024 0x791ac4ad 0xd3194125 0x433348f9 0x9880e31a 0x316f881f 0x556534f1 0xbad88423 0xe2f2b4c0 0x464e5e1d 0xcf28323f 0x7c3d7e89 0x2e4a9c45 0x6f626723 0xf35af8f0 0x78044db8 0xa4b96ad6 0x75a9461e 0x256cd0d7 0x7da12917 0x611b5063 0xdb720828 0x15bb380 0x38276c8c 0x8dcfcd07 0xefe9d9cb 0x54f38193 0x93f18a71 0x549a74c0 0xc952022b 0xcc654a91 0x3823b569 0x7acd3584 0x44d036cd 0xa32a97ac 0xd1398003 0xba14dfe8 0x48f826ac 0x49883871 0xf245016 0x922bec54 0xfd2699d1 0xb03eecd7 0xab17733e 0x2a0a7aea 0x52c4e384 0xb5a4bc03 0x17af378b 0x3d721636 0xc0b646d9 0x50f526ab 0x9a788ca5 0x3380c327 0xacd060e9 0xb27a6d58 0x423eae05 0xb4244e28 0xd2c69d58 0x8278163d 0x545fe726 0xcfc9b440 0xe0d562be 0xee755aab 0xca4a047d 0x7ce1b9e7 0x179cf117 0x27849a71 0x2530d5a3 0x5bdac0a9 0x5375145 0x3f113078 0x3be64f63 0x9fbbc3dc 0x469ccb98 0xcc638ccb 0x478c09b1 0x53832d5d 0x9454d27e 0xa35e4e06 0x12af1860 0x61a5b5e8 0xb7423566 0xda75dace 0x4b67c2a5 0x80e518b3 0xc54edade 0x8ee9c7d0 0xd44c1b63 0x882c6bc7 0x20981a0e 0xc939cd98 0x1b0bd6e4 0x31750368 0xe645dedf 0xf5edfca3 0xeca68a12 0x7937af16 0x9510a973 0x33e4af47 0xf868880 0xcd586cc8 0x5e8c7b08 0x791101ba 0x87e5b669 0xc732f158 0x83577c25 0x2717e663 0xdb6025af 0x2ff2e9b4 0xa5105198 0x1918bef5 0x2d807dd0 0xbd7e7d8 0x2ff02617 0x7a357b1d 0xc5b29af6 0xdbf4c679 0xce8fd4c7 0xda21cab3 0xcc152530 0xc861562a 0x59c91467 0x133481cf 0x3f2e0517 0x891bf8e1 0xf46d427a 0x877a6d6e 0x1a800903>;
			rsa,exponent = <0x0 0x10001>;
			rsa,n0-inverse = <0x44d25655>;
			rsa,num-bits = <0x1000>;
			key-name-hint = "fbkek2";
		};

	};
};
