## meta-facebook/meta-wedge/conf/local.conf.sample
```bitbake
#
# Local configuration file for building the OpenBMC image.
#

# Machine Selection
MACHINE ??= "wedge"

# OpenBMC distro settings
DISTRO ?= "openbmc-fb"
```

## meta-facebook/meta-wedge/conf/machine/wedge.conf
```bitbake
#@TYPE: Machine
#@NAME: Wedge
#@DESCRIPTION: Machine configuration for Facebook Wedge

require conf/machine/include/ast1250.inc
require conf/machine/include/fb-fboss.inc

KERNEL_IMAGETYPE = "zImage"
UBOOT_MACHINE:wedge = "facebook-wedge_defconfig"
UBOOT_CONFIG_BASE = "fbobmc-ast-g4_defconfig"

#
# U-boot version.
#
PREFERRED_VERSION_u-boot = "v2019.04%"
PREFERRED_VERSION_u-boot-fw-utils = "v2019.04%"
PREFERRED_VERSION_u-boot-fw-utils-cross = "v2019.04%"
PREFERRED_VERSION_u-boot-tools = "v2019.04%"
PREFERRED_VERSION_u-boot-tools-native = "v2019.04%"
PREFERRED_VERSION_nativesdk-u-boot-tools = "v2019.04%"
PREFERRED_PROVIDER_u-boot-mkimage-native = "u-boot-tools-native"

#
# Kernel version.
#
KERNEL_DEVICETREE = "aspeed-bmc-facebook-wedge40.dtb"
PREFERRED_VERSION_linux-aspeed = "5.10.%"

#
# Preferred version of user space packages.
#
PREFERRED_VERSION_libipmi = "0.2"
PREFERRED_VERSION_ipmid = "0.1"
PREFERRED_VERSION_rest-api = "0.1"
PREFERRED_VERSION_at93cx6-util = "0.1"
PREFERRED_VERSION_bcm5396-util = "0.1"
PREFERRED_VERSION_kcsd = "0.1"

MACHINE_ESSENTIAL_EXTRA_RDEPENDS += "           \
    kernel-module-fb-panther-plus               \
    "
```

## meta-facebook/meta-wedge100/conf/layer.conf
```bitbake
# We have a conf and classes directory, add to BBPATH
BBPATH .= ":${LAYERDIR}"

# We have recipes-* directories, add to BBFILES
BBFILES += "${LAYERDIR}/recipes-*/*/*.bb \
	${LAYERDIR}/recipes-*/*/*.bbappend"

BBFILE_COLLECTIONS += "wedge100"
BBFILE_PATTERN_wedge100 = "^${LAYERDIR}/"
BBFILE_PRIORITY_wedge100 = "25"

LAYERSERIES_COMPAT_wedge100 = "kirkstone dunfell rocko"

# For systemd (temporarily disabled):
DISTRO_FEATURES:append = " systemd"
VIRTUAL-RUNTIME_init_manager = "systemd"
DISTRO_FEATURES_BACKFILL_CONSIDERED += "sysvinit"
VIRTUAL-RUNTIME_initscripts = "systemd-compat-units"
```

## meta-facebook/meta-wedge100/conf/local.conf.sample
```bitbake
#
# Local configuration file for building the OpenBMC image.
#

# Machine Selection
MACHINE ??= "wedge100"

# OpenBMC distro settings
DISTRO ?= "openbmc-fb"
```

## meta-facebook/meta-wedge100/conf/machine/wedge100.conf
```bitbake
#@TYPE: Machine
#@NAME: Wedge100
#@DESCRIPTION: Machine configuration for Facebook Wedge100

require conf/machine/include/ast1250.inc
require conf/machine/include/fb-fboss.inc
require conf/machine/include/tpm1.inc

KERNEL_IMAGETYPE = "zImage"
UBOOT_MACHINE:wedge100 = "facebook-wedge100_defconfig"
UBOOT_CONFIG_BASE = "fbobmc-ast-g4_defconfig"

# configuration for preferred version of packages
PREFERRED_VERSION_u-boot = "v2019.04%"
PREFERRED_VERSION_u-boot-fw-utils = "v2019.04%"
PREFERRED_VERSION_u-boot-fw-utils-cross = "v2019.04%"
PREFERRED_VERSION_u-boot-tools = "v2019.04%"
PREFERRED_VERSION_u-boot-tools-native = "v2019.04%"
PREFERRED_VERSION_nativesdk-u-boot-tools = "v2019.04%"
PREFERRED_PROVIDER_u-boot-mkimage-native = "u-boot-tools-native"

#
# Kernel version.
#
KERNEL_DEVICETREE = "aspeed-bmc-facebook-wedge100.dtb"
PREFERRED_VERSION_linux-aspeed = "6.0.%"

#
# Preferred version of user space packages.
#
PREFERRED_VERSION_libipmi = "0.2"
PREFERRED_VERSION_ipmid = "0.2"
PREFERRED_VERSION_rest-api = "0.1"
PREFERRED_VERSION_at93cx6-util = "0.1"
PREFERRED_VERSION_bcm5396-util = "0.1"
PREFERRED_VERSION_openbmc-gpio = "0.2"
PREFERRED_VERSION_kcsd = "0.2"
PREFERRED_VERSION_fscd = "0.3"

MACHINE_ESSENTIAL_EXTRA_RDEPENDS += "           \
    kernel-module-i2c-dev-sysfs                 \
    kernel-module-cpld                          \
    kernel-module-com-e-driver                  \
    kernel-module-i2c                           \
    "
```

## meta-facebook/meta-wedge400/conf/machine/wedge400.conf
```bitbake
#@TYPE: Machine
#@NAME: Wedge400
#@DESCRIPTION: Machine configuration for Facebook Wedge400

require conf/machine/include/ast2520.inc

UBOOT_MACHINE:wedge400 = "fbwedge400_config"
PREFERRED_VERSION_u-boot = "v2019.04%"
PREFERRED_VERSION_u-boot-tools = "v2019.04%"
PREFERRED_VERSION_u-boot-tools-native = "v2019.04%"
PREFERRED_VERSION_nativesdk-u-boot-tools = "v2019.04%"
PREFERRED_VERSION_u-boot-fw-utils = "v2019.04%"
PREFERRED_VERSION_u-boot-fw-utils-cross = "v2019.04%"

KERNEL_IMAGETYPE = "zImage"

KERNEL_DEVICETREE = "aspeed-bmc-facebook-wedge400.dtb"
PREFERRED_VERSION_linux-aspeed = "6.0.%"
PREFERRED_VERSION_libwatchdog = "0.2"
PREFERRED_VERSION_libipmi = "0.2"
PREFERRED_VERSION_ipmid = "0.2"
PREFERRED_VERSION_libbic = "0.2"
PREFERRED_VERSION_bic-util = "0.2"
PREFERRED_VERSION_rest-api = "0.1"
PREFERRED_VERSION_at93cx6-util = "0.1"
PREFERRED_VERSION_bcm5396-util = "0.1"
PREFERRED_VERSION_fscd = "0.3"
PREFERRED_VERSION_openbmc-gpio = "0.2"
PREFERRED_VERSION_fw-util = "0.2"

MACHINE_ESSENTIAL_EXTRA_RDEPENDS += "           \
    kernel-module-i2c-dev-sysfs                 \
    kernel-module-i2c-dev-psu                   \
    kernel-module-i2c-dev-domfpga               \
    kernel-module-cpld                          \
    kernel-module-i2c                           \
    "

require conf/machine/include/mtd-ubifs.inc
require conf/machine/include/tpm2.inc
MACHINE_FEATURES += "emmc emmc-ext4"

EXTRA_IMAGE_FEATURES:append = " image-meta"
FW_ENV_CONFIG_FILE = "fw_env.config.64k"
```

## meta-facebook/meta-yamp/conf/layer.conf
```bitbake
# We have a conf and classes directory, add to BBPATH
BBPATH .= ":${LAYERDIR}"

# We have recipes-* directories, add to BBFILES
BBFILES += "${LAYERDIR}/recipes-*/*/*.bb \
	          ${LAYERDIR}/recipes-*/*/*.bbappend \
            ${LAYERDIR}/facebook/recipes-*/*/*.bb \
	          ${LAYERDIR}/facebook/recipes-*/*/*.bbappend"

BBFILE_COLLECTIONS += "yamp"
BBFILE_PATTERN_yamp = "^${LAYERDIR}/"
BBFILE_PRIORITY_yamp = "20"
LAYERSERIES_COMPAT_yamp = "kirkstone honister dunfell rocko"
```

## meta-facebook/meta-yamp/conf/machine/yamp.conf
```bitbake
#@TYPE: Machine
#@NAME: YAMP
#@DESCRIPTION: Machine configuration for Facebook YAMP

require conf/machine/include/ast2520.inc
require conf/machine/include/fb-fboss.inc

KERNEL_IMAGETYPE = "zImage"
UBOOT_MACHINE:yamp = "fbyamp_config"

#
# Kernel version.
#
KERNEL_DEVICETREE = "aspeed-bmc-facebook-yamp.dtb"
PREFERRED_VERSION_linux-aspeed = "6.1.%"

#
# U-boot version.
#
PREFERRED_VERSION_u-boot = "v2019.04%"
PREFERRED_VERSION_u-boot-tools = "v2019.04%"
PREFERRED_VERSION_u-boot-tools-native = "v2019.04%"
PREFERRED_VERSION_nativesdk-u-boot-tools = "v2019.04%"
PREFERRED_VERSION_u-boot-fw-utils = "v2019.04%"
PREFERRED_VERSION_u-boot-fw-utils-cross = "v2019.04%"

#
# Preferred version of user space packages.
#
PREFERRED_VERSION_rest-api = "0.1"
PREFERRED_VERSION_openbmc-gpio = "0.2"
PREFERRED_VERSION_fscd = "0.3"

MACHINE_ESSENTIAL_EXTRA_RDEPENDS += "           \
    kernel-module-i2c-dev-sysfs                 \
    kernel-module-cpld                          \
    "

MACHINE_FEATURES += "emmc emmc-ext4"
```

## meta-facebook/meta-yosemite/conf/layer.conf
```bitbake
# We have a conf and classes directory, add to BBPATH
BBPATH .= ":${LAYERDIR}"

# We have recipes-* directories, add to BBFILES
BBFILES += "${LAYERDIR}/recipes-*/*/*.bb \
	${LAYERDIR}/recipes-*/*/*.bbappend"

BBFILE_COLLECTIONS += "yosemite"
BBFILE_PATTERN_yosemite = "^${LAYERDIR}/"
BBFILE_PRIORITY_yosemite = "20"

LAYERSERIES_COMPAT_yosemite = "mickledore kirkstone dunfell rocko"
```

## meta-facebook/meta-yosemite/conf/machine/yosemite.conf
```bitbake
#@TYPE: Machine
#@NAME: Yosemite
#@DESCRIPTION: Machine configuration for Facebook Yosemite

UBOOT_MACHINE_yosemite = "fbyosemite_config"

PREFERRED_VERSION_u-boot = "v2016.07"
PREFERRED_VERSION_u-boot-mkimage = "v2016.07"
PREFERRED_VERSION_u-boot-fw-utils = "v2016.07"
PREFERRED_VERSION_libwatchdog = "0.1"
PREFERRED_VERSION_libbic = "0.1"
PREFERRED_VERSION_bic-util = "0.1"
PREFERRED_VERSION_libpal = "0.2"

KERNEL_IMAGETYPE = "zImage"

require conf/machine/include/ast1250.inc
```

## meta-facebook/meta-yosemite4/conf/layer.conf
```bitbake
# We have a conf and classes directory, add to BBPATH
BBPATH .= ":${LAYERDIR}"

# We have recipes-* directories, add to BBFILES
BBFILES += "${LAYERDIR}/recipes-*/*/*.bb \
	        ${LAYERDIR}/recipes-*/*/*.bbappend"

BBFILE_COLLECTIONS += "fb-yosemite4-layer"
BBFILE_PATTERN_fb-yosemite4-layer := "^${LAYERDIR}/"

LAYERSERIES_COMPAT_fb-yosemite4-layer = "mickledore kirkstone"
```

## meta-facebook/meta-yosemite4/meta-yosemite4n/conf/layer.conf
```bitbake
# We have a conf and classes directory, add to BBPATH
BBPATH .= ":${LAYERDIR}"

# We have recipes-* directories, add to BBFILES
BBFILES += "${LAYERDIR}/recipes-*/*/*.bb \
	        ${LAYERDIR}/recipes-*/*/*.bbappend"

# Ignore bbappend related to ASPEED in meta-yosemite4
BBMASK += ".*aspeed.*\.bbappend"

BBFILE_COLLECTIONS += "fb-yosemite4n-layer"
BBFILE_PATTERN_fb-yosemite4n-layer := "^${LAYERDIR}/"
LAYERVERSION_fb-yosemite4n-layer = "1"
LAYERSERIES_COMPAT_fb-yosemite4n-layer = "scarthgap nanbield kirkstone"
```

## meta-nuvoton/conf/layer.conf
```bitbake
BBPATH .= ":${LAYERDIR}"

BBFILES += "${LAYERDIR}/recipes-*/*/*.bb \
            ${LAYERDIR}/recipes-*/*/*.bbappend"

BBFILE_COLLECTIONS += "nuvoton-layer-fb"
BBFILE_PATTERN_nuvoton-layer-fb = ""
LAYERVERSION_nuvoton-layer-fb = "1"
LAYERSERIES_COMPAT_nuvoton-layer-fb = "mickledore kirkstone"
```

## meta-portwell/meta-pwneptune/conf/layer.conf
```bitbake
# We have a conf and classes directory, add to BBPATH
BBPATH .= ":${LAYERDIR}"

# We have recipes-* directories, add to BBFILES
BBFILES += "${LAYERDIR}/recipes-*/*/*.bb \
	${LAYERDIR}/recipes-*/*/*.bbappend"

BBFILE_COLLECTIONS += "pwneptune"
BBFILE_PATTERN_pwneptune = "^${LAYERDIR}/"
BBFILE_PRIORITY_pwneptune = "20"
```

## meta-portwell/meta-pwneptune/conf/machine/pwneptune.conf
```bitbake
#@TYPE: Machine
#@NAME: PWNeptune
#@DESCRIPTION: Machine configuration for Portwell Neptune

UBOOT_MACHINE_pwneptune = "pwneptune_config"

PREFERRED_VERSION_u-boot = "v2016.07"
PREFERRED_VERSION_u-boot-mkimage = "v2016.07"
PREFERRED_VERSION_u-boot-fw-utils = "v2016.07"
PREFERRED_VERSION_bios-util = "0.2"
PREFERRED_VERSION_at93cx6-util = "0.1"

KERNEL_IMAGETYPE = "zImage"

require conf/machine/include/ast2520.inc

# configuration for preferred version of packages
```

## meta-zephyr/meta-zephyr-core/conf/distro/zephyr.conf
```bitbake
DISTRO = "zephyr"
DISTRO_NAME = "Zephyr"
DISTRO_VERSION = "1.0"

TARGET_VENDOR = "-yocto"

TCLIBC ?= "newlib"

TEST_TARGET = "QemuTargetZephyr"
TEST_SUITES = "zephyr"

INHERIT += "siteinfo-zephyr"

INHERIT += "uninative"
require conf/distro/include/yocto-uninative.inc
```

## tools/fboss-lite/fblite-ref-layer/conf/layer.conf
```bitbake
# Copyright (c) Meta Platforms, Inc. and affiliates.
#
# This program file is free software; you can redistribute it and/or modify it
# under the terms of the GNU General Public License as published by the
# Free Software Foundation; version 2 of the License.
#
# This program is distributed in the hope that it will be useful, but WITHOUT
# ANY WARRANTY; without even the implied warranty of MERCHANTABILITY or
# FITNESS FOR A PARTICULAR PURPOSE.  See the GNU General Public License
# for more details.
#
# You should have received a copy of the GNU General Public License
# along with this program in a file named COPYING; if not, write to the
# Free Software Foundation, Inc.,
# 51 Franklin Street, Fifth Floor,
# Boston, MA 02110-1301 USA

BBPATH .= ":${LAYERDIR}"

# We have recipes-* directories, add to BBFILES
BBFILES += "${LAYERDIR}/recipes-*/*/*.bb \
            ${LAYERDIR}/recipes-*/*/*.bbappend"

BBFILE_COLLECTIONS += "@FBMODEL@"
BBFILE_PATTERN_@FBMODEL@ = "^${LAYERDIR}/"
BBFILE_PRIORITY_@FBMODEL@ = "25"

LAYERSERIES_COMPAT_@FBMODEL@ = "langdale kirkstone dunfell"

DISTRO_FEATURES:append = " systemd"
VIRTUAL-RUNTIME_init_manager = "systemd"
DISTRO_FEATURES_BACKFILL_CONSIDERED += "sysvinit"
VIRTUAL-RUNTIME_initscripts = "systemd-compat-units"
```
