## meta-facebook/meta-fby2/conf/layer.conf
```bitbake
# We have a conf and classes directory, add to BBPATH
BBPATH .= ":${LAYERDIR}"

# We have recipes-* directories, add to BBFILES
BBFILES += "${LAYERDIR}/recipes-*/*/*.bb \
	${LAYERDIR}/recipes-*/*/*.bbappend"

BBFILE_COLLECTIONS += "fby2"
BBFILE_PATTERN_fby2 = "^${LAYERDIR_RE}/recipes"
BBFILE_PRIORITY_fby2 = "20"

LAYERSERIES_COMPAT_fby2 = "kirkstone dunfell rocko"
```

## meta-facebook/meta-fby2/conf/local.conf.sample
```bitbake
#
# Local configuration file for building the OpenBMC image.
#

# Machine Selection
MACHINE ??= "fby2"

# OpenBMC distro settings
DISTRO ?= "openbmc-fb"
```

## meta-facebook/meta-fby2/conf/machine/fby2-ubu.conf
```bitbake
#@TYPE: Machine
#@NAME: FBY2
#@DESCRIPTION: Machine configuration for Facebook FBY2

UBOOT_MACHINE:fby2-ubu = "fby2_config"

PREFERRED_VERSION_u-boot = "v2019.01"
PREFERRED_VERSION_u-boot-tools = "v2019.01"
PREFERRED_VERSION_u-boot-tools-native = "v2019.01"
PREFERRED_VERSION_nativesdk-u-boot-tools = "v2019.01"
PREFERRED_VERSION_u-boot-fw-utils = "v2019.01"
PREFERRED_VERSION_u-boot-fw-utils-cross = "v2019.01"
PREFERRED_VERSION_bios-util = "0.2"
PREFERRED_VERSION_libwatchdog = "0.1"
PREFERRED_VERSION_libbic = "0.1"
PREFERRED_VERSION_bic-util = "0.1"

KERNEL_IMAGETYPE = "zImage"

require conf/machine/include/ast2520.inc

require conf/machine/include/fb-compute.inc
require conf/machine/include/tpm1.inc
```

## meta-facebook/meta-fby2/conf/machine/fby2.conf
```bitbake
#@TYPE: Machine
#@NAME: FBY2
#@DESCRIPTION: Machine configuration for Facebook FBY2

UBOOT_MACHINE:fby2 = "fby2_config"

PREFERRED_VERSION_u-boot = "v2016.07"
PREFERRED_VERSION_u-boot-mkimage = "v2016.07"
PREFERRED_VERSION_u-boot-fw-utils = "v2016.07"
PREFERRED_VERSION_bios-util = "0.2"
PREFERRED_VERSION_libwatchdog = "0.1"
PREFERRED_VERSION_libbic = "0.1"
PREFERRED_VERSION_bic-util = "0.1"

KERNEL_IMAGETYPE = "zImage"

require conf/machine/include/ast2520.inc
require conf/distro/openbmc-pin-rocko.inc

require conf/machine/include/fb-compute.inc
require conf/machine/include/tpm1.inc
```

## meta-facebook/meta-fby2/meta-fby2-ep/conf/bblayers.conf.sample
```bitbake
# LAYER_CONF_VERSION is increased each time build/conf/bblayers.conf
# changes incompatibly
LCONF_VERSION = "6"

BBPATH = "${TOPDIR}"
BBFILES ?= ""

BBLAYERS ?= " \
  ##OEROOT##/meta \
  ##OEROOT##/meta-poky \
  ##OEROOT##/meta-yocto-bsp \
  ##OEROOT##/meta-openembedded/meta-oe \
  ##OEROOT##/meta-openembedded/meta-networking \
  ##OEROOT##/meta-openembedded/meta-python \
  ##OEROOT##/meta-openbmc \
  ##OEROOT##/meta-openbmc/meta-aspeed \
  ##OEROOT##/meta-openbmc/meta-facebook \
  ##OEROOT##/meta-openbmc/meta-facebook/meta-fby2 \
  ##OEROOT##/meta-openbmc/meta-facebook/meta-fby2/meta-fby2-ep \
  ##OEROOT##/meta-openbmc/meta-facebook/meta-python3 \
  "
BBLAYERS_NON_REMOVABLE ?= " \
  ##OEROOT##/meta \
  ##OEROOT##/meta-poky \
  "
```

## meta-facebook/meta-fby2/meta-fby2-gpv2/conf/layer.conf
```bitbake
# We have a conf and classes directory, add to BBPATH
BBPATH .= ":${LAYERDIR}"

# We have recipes-* directories, add to BBFILES
BBFILES += "${LAYERDIR}/recipes-*/*/*.bb \
	${LAYERDIR}/recipes-*/*/*.bbappend"

BBFILE_COLLECTIONS += "fby2-gpv2"
BBFILE_PATTERN_fby2-gpv2 = "^${LAYERDIR}/"
BBFILE_PRIORITY_fby2-gpv2 = "25"

LAYERSERIES_COMPAT_fby2-gpv2 = "kirkstone honister dunfell rocko"
```

## meta-facebook/meta-fby2/meta-fby2-gpv2/conf/machine/fbgp2.conf
```bitbake
#@TYPE: Machine
#@NAME: FBGP2
#@DESCRIPTION: Machine configuration for Facebook FBGP2

UBOOT_MACHINE:fbgp2 = "fby2_config"

PREFERRED_VERSION_u-boot = "v2016.07%"
PREFERRED_VERSION_u-boot-mkimage = "v2016.07%"
PREFERRED_VERSION_u-boot-fw-utils = "v2016.07%"
PREFERRED_VERSION_bios-util = "0.2"
PREFERRED_VERSION_libwatchdog = "0.1"
PREFERRED_VERSION_libbic = "0.1"
PREFERRED_VERSION_bic-util = "0.1"
PREFERRED_VERSION_libasd-jtagintf = "0.1"
PREFERRED_VERSION_asd = "0.1"
PREFERRED_VERSION_asd-test = "0.1"

KERNEL_IMAGETYPE = "zImage"

require conf/machine/include/ast2520.inc

require conf/machine/include/fb-compute.inc
require conf/machine/include/tpm1.inc
```

## meta-facebook/meta-fby2/meta-fby2-kernel/conf/layer.conf
```bitbake
# We have a conf and classes directory, add to BBPATH
BBPATH .= ":${LAYERDIR}"

# We have recipes-* directories, add to BBFILES
BBFILES += "${LAYERDIR}/recipes-*/*/*.bb \
	${LAYERDIR}/recipes-*/*/*.bbappend"

BBFILE_COLLECTIONS += "fby2-kernel"
BBFILE_PATTERN_fby2-kernel = "^${LAYERDIR}/"
BBFILE_PRIORITY_fby2-kernel = "25"
```

## meta-facebook/meta-fby2/meta-fby2-kernel/conf/machine/fby2-kernel.conf
```bitbake
#@TYPE: Machine
#@NAME: FBY2-KERNEL
#@DESCRIPTION: Machine configuration for Facebook FBY2

require conf/machine/include/ast2520.inc

UBOOT_MACHINE:fby2-kernel = "fby2_config"
KERNEL_IMAGETYPE = "zImage"

KERNEL_DEVICETREE = "aspeed-bmc-facebook-yosemitev2.dtb"
PREFERRED_VERSION_linux-aspeed = "5.0.3%"
PREFERRED_VERSION_libasd-jtagintf = "0.1"
PREFERRED_VERSION_asd = "0.1"
PREFERRED_VERSION_asd-test = "0.1"

PREFERRED_VERSION_u-boot = "v2016.07%"
PREFERRED_VERSION_u-boot-mkimage = "v2016.07%"
PREFERRED_VERSION_u-boot-fw-utils = "v2016.07%"

PREFERRED_VERSION_bios-util = "0.2"
PREFERRED_VERSION_libwatchdog = "0.2"

require conf/machine/include/ncsi.inc
require conf/machine/include/tpm1.inc
```

## meta-facebook/meta-fby2/meta-fby2-nd/conf/layer.conf
```bitbake
# We have a conf and classes directory, add to BBPATH
BBPATH .= ":${LAYERDIR}"

# We have recipes-* directories, add to BBFILES
BBFILES += "${LAYERDIR}/recipes-*/*/*.bb \
  ${LAYERDIR}/recipes-*/*/*.bbappend"

BBFILE_COLLECTIONS += "fby2-nd"
BBFILE_PATTERN_fby2-nd = "^${LAYERDIR}/"
BBFILE_PRIORITY_fby2-nd = "25"

LAYERSERIES_COMPAT_fby2-nd = "zeus warrior rocko"
```

## meta-facebook/meta-fby2/meta-fby2-nd/conf/machine/fby2-nd.conf
```bitbake
#@TYPE: Machine
#@NAME: FBY2-NorthDome
#@DESCRIPTION: Machine configuration for Facebook FBY2 NorthDome

# baseline fby2 uboot
UBOOT_MACHINE_fby2-nd = "fby2_config"

PREFERRED_VERSION_u-boot = "v2019.01"
PREFERRED_VERSION_u-boot-mkimage = "v2019.01"
PREFERRED_VERSION_u-boot-mkimage-native = "v2019.01"
PREFERRED_VERSION_nativesdk-u-boot-mkimage = "v2019.01"
PREFERRED_VERSION_u-boot-fw-utils = "v2019.01"
PREFERRED_VERSION_u-boot-fw-utils-cross = "v2019.01"

PREFERRED_VERSION_bios-util = "0.2"

KERNEL_IMAGETYPE = "zImage"

require conf/machine/include/ast2520.inc

# configuration for preferred version of packages
```

## meta-facebook/meta-fby2/meta-fby2-nd/conf/machine/northdome.conf
```bitbake
#@TYPE: Machine
#@NAME: FBY2-NorthDome
#@DESCRIPTION: Machine configuration for Facebook FBY2 NorthDome

# baseline fby2 uboot
UBOOT_MACHINE:northdome = "fby2_defconfig"
UBOOT_MACHINE:northdome-vboot = "fby2_defconfig"
UBOOT_CONFIG_BASE = "fbobmc-ast-g5-tpm2_defconfig"
UBOOT_CONFIG_BASE:northdome-vboot = "fbobmc-ast-g5-tpm2_defconfig"

KERNEL_DEVICETREE = "aspeed-bmc-facebook-northdome.dtb"

PREFERRED_VERSION_u-boot = "v2019.04"
PREFERRED_VERSION_u-boot-tools= "v2019.04"
PREFERRED_VERSION_u-boot-tools-native = "v2019.04"
PREFERRED_VERSION_nativesdk-u-boot-tools = "v2019.04"
PREFERRED_VERSION_u-boot-fw-utils = "v2019.04"
PREFERRED_VERSION_u-boot-fw-utils-cross = "v2019.04"
PREFERRED_VERSION_libbic = "0.1"
PREFERRED_VERSION_bic-util = "0.1"

PREFERRED_VERSION_bios-util = "0.2"

PREFERRED_VERSION_linux-aspeed = "5.6.19"
KERNEL_IMAGETYPE = "zImage"

require conf/machine/include/ast2520.inc

require conf/machine/include/fb-bic.inc
require conf/machine/include/ncsi.inc

EXTRA_IMAGE_FEATURES:append = " verified-boot image-meta"
FW_ENV_CONFIG_FILE = "fw_env.config.64k"

MACHINE_FEATURES += "tpm2 mtd-ubifs"
MACHINE_FEATURES += "compute-rest"

# configuration for preferred version of packages
```

## meta-facebook/meta-fby2/meta-fby2-rc/conf/bblayers.conf
```bitbake
# POKY_BBLAYERS_CONF_VERSION is increased each time build/conf/bblayers.conf
# changes incompatibly
POKY_BBLAYERS_CONF_VERSION = "2"

BBPATH = "${TOPDIR}"
BBFILES ?= ""

BBLAYERS ?= " \
  /data/users/benwei/github/poky-wiwynn/meta \
  /data/users/benwei/github/poky-wiwynn/meta-poky \
  /data/users/benwei/github/poky-wiwynn/meta-yocto-bsp \
  "
```

## meta-facebook/meta-fby2/meta-fby2-rc/conf/layer.conf
```bitbake
# We have a conf and classes directory, add to BBPATH
BBPATH .= ":${LAYERDIR}"

# We have recipes-* directories, add to BBFILES
BBFILES += "${LAYERDIR}/recipes-*/*/*.bb \
	${LAYERDIR}/recipes-*/*/*.bbappend"

BBFILE_COLLECTIONS += "fby2-rc"
BBFILE_PATTERN_fby2-rc = "^${LAYERDIR}/"
BBFILE_PRIORITY_fby2-rc = "25"
```

## meta-facebook/meta-fby2/meta-fby2-rc/conf/machine/fby2.conf
```bitbake
#@TYPE: Machine
#@NAME: FBY2
#@DESCRIPTION: Machine configuration for Facebook FBY2

UBOOT_MACHINE_fby2 = "fby2_config"

PREFERRED_VERSION_u-boot = "v2016.07"
PREFERRED_VERSION_u-boot-mkimage = "v2016.07"
PREFERRED_VERSION_u-boot-fw-utils = "v2016.07"
PREFERRED_VERSION_bios-util = "0.2"
PREFERRED_VERSION_libbic = "0.1"
PREFERRED_VERSION_bic-util = "0.1"
PREFERRED_VERSION_libpal = "0.2"

KERNEL_IMAGETYPE = "zImage"

require conf/machine/include/ast2520.inc

# configuration for preferred version of packages
```

## meta-facebook/meta-fby2/meta-fby2-tl/conf/layer.conf
```bitbake
# We have a conf and classes directory, add to BBPATH
BBPATH .= ":${LAYERDIR}"

# We have recipes-* directories, add to BBFILES
BBFILES += "${LAYERDIR}/recipes-*/*/*.bb \
	${LAYERDIR}/recipes-*/*/*.bbappend"

BBFILE_COLLECTIONS += "fby2-tl"
BBFILE_PATTERN_fby2-tl = "^${LAYERDIR}/"
BBFILE_PRIORITY_fby2-tl = "25"

LAYERSERIES_COMPAT_fby2-tl = "zeus warrior rocko"
```

## meta-facebook/meta-fby2/meta-fby3-poc/conf/layer.conf
```bitbake
# We have a conf and classes directory, add to BBPATH
BBPATH .= ":${LAYERDIR}"

# We have recipes-* directories, add to BBFILES
BBFILES += "${LAYERDIR}/recipes-*/*/*.bb \
  ${LAYERDIR}/recipes-*/*/*.bbappend"

BBFILE_COLLECTIONS += "fby3-poc"
BBFILE_PATTERN_fby3-poc = "^${LAYERDIR}/"
BBFILE_PRIORITY_fby3-poc = "25"
```

## meta-facebook/meta-fby2/meta-fby3-poc/conf/machine/fby2.conf
```bitbake
#@TYPE: Machine
#@NAME: FBY3-POC
#@DESCRIPTION: Machine configuration for Facebook FBY3 POC

# baseline fby2 uboot
UBOOT_MACHINE_fby3-poc = "fby2_config"

PREFERRED_VERSION_u-boot = "v2016.07"
PREFERRED_VERSION_u-boot-mkimage = "v2016.07"
PREFERRED_VERSION_u-boot-fw-utils = "v2016.07"
PREFERRED_VERSION_bios-util = "0.2"
PREFERRED_VERSION_libbic = "0.1"
PREFERRED_VERSION_bic-util = "0.1"

KERNEL_IMAGETYPE = "zImage"

require conf/machine/include/ast2520.inc

# configuration for preferred version of packages
```

## meta-facebook/meta-fby3/conf/layer.conf
```bitbake
# We have a conf and classes directory, add to BBPATH
BBPATH .= ":${LAYERDIR}"

# We have recipes-* directories, add to BBFILES
BBFILES += "${LAYERDIR}/recipes-*/*/*.bb \
	${LAYERDIR}/recipes-*/*/*.bbappend"

BBFILE_COLLECTIONS += "fby3"
BBFILE_PATTERN_fby3 = "^${LAYERDIR}/"
BBFILE_PRIORITY_fby3 = "20"

LAYERSERIES_COMPAT_fby3 = "kirkstone dunfell"
```

## meta-facebook/meta-fby3/conf/local.conf.sample
```bitbake
#
# Local configuration file for building the OpenBMC image.
#

# Machine Selection
MACHINE ??= "fby3"
# VBoot w/ TPM1.2
# MACHINE ??= "fby3-vboot1"
# VBoot w/ TPM2.0
# MACHINE ??= "fby3-vboot2"


# OpenBMC distro settings
DISTRO ?= "openbmc-fb"
```

## meta-facebook/meta-fby3/conf/machine/fby3-vboot1.conf
```bitbake
#@TYPE: Machine
#@NAME: FBY3
#@DESCRIPTION: Machine configuration for Facebook FBY3
require conf/machine/include/ast2520.inc

UBOOT_MACHINE_fby3-vboot1 = "fby3_defconfig"
UBOOT_CONFIG_BASE = "fbobmc-ast-g5-tpm1_defconfig"
KERNEL_IMAGETYPE = "zImage"
KERNEL_DEVICETREE = "aspeed-bmc-facebook-yosemitev3-vboot1.dtb"

# configuration for preferred version of packages
PREFERRED_VERSION_u-boot = "v2019.01"
PREFERRED_VERSION_u-boot-fw-utils = "v2019.01"
PREFERRED_VERSION_u-boot-fw-utils-cross = "v2019.01"
PREFERRED_VERSION_u-boot-tools = "v2019.01"
PREFERRED_VERSION_u-boot-tools-native = "v2019.01"
PREFERRED_VERSION_nativesdk-u-boot-tools = "v2019.01"

PREFERRED_VERSION_bios-util = "0.2"
PREFERRED_VERSION_libwatchdog = "0.2"
PREFERRED_VERSION_libbic = "0.1"
PREFERRED_VERSION_bic-util = "0.1"
PREFERRED_VERSION_linux-aspeed = "5.0.3"
PREFERRED_VERSION_libpal = "0.2"

MACHINE_FEATURES += "tpm1"
MACHINE_FEATURES += "emmc"
MACHINE_FEATURES += "bic"

EXTRA_IMAGE_FEATURES_append = " verified-boot "
```

## meta-facebook/meta-fby3/conf/machine/fby3.conf
```bitbake
#@TYPE: Machine
#@NAME: FBY3
#@DESCRIPTION: Machine configuration for Facebook FBY3
require conf/machine/include/ast2520.inc

UBOOT_MACHINE:fby3 = "fby3_defconfig"
UBOOT_CONFIG_BASE = "fbobmc-ast-g5-tpm2_defconfig"
KERNEL_IMAGETYPE = "zImage"
KERNEL_DEVICETREE = "aspeed-bmc-facebook-yosemitev3.dtb"

# configuration for preferred version of packages
PREFERRED_VERSION_u-boot = "v2019.04"
PREFERRED_VERSION_u-boot-fw-utils = "v2019.04"
PREFERRED_VERSION_u-boot-fw-utils-cross = "v2019.04"
PREFERRED_VERSION_u-boot-tools = "v2019.04"
PREFERRED_VERSION_u-boot-tools-native = "v2019.04"
PREFERRED_VERSION_nativesdk-u-boot-tools = "v2019.04"

PREFERRED_VERSION_bios-util = "0.2"
PREFERRED_VERSION_libwatchdog = "0.2"
PREFERRED_VERSION_libbic = "0.1"
PREFERRED_VERSION_bic-util = "0.1"
PREFERRED_VERSION_linux-aspeed = "5.0.3"
PREFERRED_VERSION_asd = "1.4.3"

require conf/machine/include/ncsi.inc

MACHINE_FEATURES += "tpm2"
MACHINE_FEATURES += "bic"
MACHINE_FEATURES += "compute-rest"
EXTRA_IMAGE_FEATURES:append = " verified-boot image-meta"
FW_ENV_CONFIG_FILE = "fw_env.config.64k"
```

## meta-facebook/meta-fby3/meta-fby3s/conf/layer.conf
```bitbake
# We have a conf and classes directory, add to BBPATH
BBPATH .= ":${LAYERDIR}"

# We have recipes-* directories, add to BBFILES
BBFILES += "${LAYERDIR}/recipes-*/*/*.bb \
	${LAYERDIR}/recipes-*/*/*.bbappend"

BBFILE_COLLECTIONS += "fby3s"
BBFILE_PATTERN_fby3s = "^${LAYERDIR}/"
BBFILE_PRIORITY_fby3s = "20"

LAYERSERIES_COMPAT_fby3s = "zeus warrior rocko"
```

## meta-facebook/meta-fby3/meta-fby3s/conf/local.conf.sample
```bitbake
#
# Local configuration file for building the OpenBMC image.
#

# Machine Selection
# PFR
MACHINE ??= "fby3s"

# OpenBMC distro settings
DISTRO ?= "openbmc-fb"
```
