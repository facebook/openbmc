## meta-facebook/meta-fbtp/conf/machine/fbtp.conf
```bitbake
#@TYPE: Machine
#@NAME: FBTP
#@DESCRIPTION: Machine configuration for Facebook FBTP

UBOOT_MACHINE_fbtp = "fbtp_config"

PREFERRED_VERSION_u-boot = "v2016.07"
PREFERRED_VERSION_u-boot-mkimage = "v2016.07"
PREFERRED_VERSION_u-boot-fw-utils = "v2016.07"
PREFERRED_VERSION_bios-util = "0.2"
PREFERRED_VERSION_at93cx6-util = "0.1"

# Preferred version for 4.1
PREFERRED_VERSION_libwatchdog = "0.1"
# Comment above and uncomment below to
# test build with linux-kernel 5.0.
# KERNEL_DEVICETREE = "aspeed-bmc-facebook-tiogapass.dtb"
# PREFERRED_VERSION_linux-aspeed = "5.0.3"
# PREFERRED_VERSION_libwatchdog = "0.2"

KERNEL_IMAGETYPE = "zImage"

require conf/machine/include/ast2520.inc

# configuration for preferred version of packages
MACHINE_FEATURES += "tpm1"
```

## meta-facebook/meta-fbttn/conf/layer.conf
```bitbake
# We have a conf and classes directory, add to BBPATH
BBPATH .= ":${LAYERDIR}"

# We have recipes-* directories, add to BBFILES
BBFILES += "${LAYERDIR}/recipes-*/*/*.bb \
	${LAYERDIR}/recipes-*/*/*.bbappend"

BBFILE_COLLECTIONS += "fbttn"
BBFILE_PATTERN_fbttn = "^${LAYERDIR}/"
BBFILE_PRIORITY_fbttn = "20"

LAYERSERIES_COMPAT_fbttn = "mickledore kirkstone dunfell rocko"
```

## meta-facebook/meta-fbttn/conf/machine/fbttn.conf
```bitbake
#@TYPE: Machine
#@NAME: FBTTN
#@DESCRIPTION: Machine configuration for Facebook FBTTN

UBOOT_MACHINE:fbttn = "fbttn_config"

PREFERRED_VERSION_u-boot = "v2016.07"
PREFERRED_VERSION_u-boot-mkimage = "v2016.07"
PREFERRED_VERSION_u-boot-fw-utils = "v2016.07"
PREFERRED_VERSION_vboot-utils = "2.0"
PREFERRED_VERSION_libwatchdog = "0.1"
PREFERRED_VERSION_libbic = "0.1"
PREFERRED_VERSION_bic-util = "0.1"
KERNEL_IMAGETYPE = "zImage"

require conf/machine/include/ast2520.inc

require conf/machine/include/fb-compute.inc
require conf/machine/include/tpm1.inc
```

## meta-facebook/meta-fbttn/meta-fbttn2/conf/layer.conf
```bitbake
BBPATH .= ":${LAYERDIR}"
BBFILES += " \
    ${LAYERDIR}/recipes-*/*/*.bb \
    ${LAYERDIR}/recipes-*/*/*.bbappend \
"
BBFILE_COLLECTIONS += "fbttn2"
BBFILE_PATTERN_fbttn2 = "^${LAYERDIR}/"
BBFILE_PRIORITY_fbttn2 = "20"
LAYERSERIES_COMPAT_fbttn2 = "mickledore kirkstone dunfell"
```

## meta-facebook/meta-fbttn/meta-fbttn2/conf/machine/fbttn2.conf
```bitbake
#@TYPE: Machine
#@NAME: fbttn2
#@DESCRIPTION: Bryce Canyon BMC

require conf/machine/include/ast2520.inc

UBOOT_MACHINE = "evb-ast2500_defconfig"
UBOOT_DEVICETREE = "ast2500-evb"

PREFERRED_VERSION_u-boot = "v2019.04%"
PREFERRED_VERSION_u-boot-tools = "v2019.04%"
PREFERRED_VERSION_u-boot-tools-native = "v2019.04%"
PREFERRED_VERSION_nativesdk-u-boot-tools = "v2019.04%"
PREFERRED_VERSION_u-boot-fw-utils = "v2019.04%"
PREFERRED_VERSION_u-boot-fw-utils-cross = "v2019.04%"

KMACHINE = "aspeed"
KERNEL_IMAGETYPE = "zImage"
KERNEL_DEVICETREE = "aspeed-ast2500-evb.dtb"

PREFERRED_VERSION_linux-aspeed = "6.0.%"
PREFERRED_VERSION_libwatchdog = "0.2"

SERIAL_CONSOLES = "115200;ttyS4"
FLASH_SIZE = "32768"

EXTRA_IMAGE_FEATURES += "image-meta"
```
