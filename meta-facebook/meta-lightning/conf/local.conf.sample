## meta-facebook/meta-lightning/conf/local.conf.sample
```bitbake
#
# Local configuration file for building the OpenBMC image.
#

# Machine Selection
MACHINE ??= "lightning"

# OpenBMC distro settings
DISTRO ?= "openbmc-fb"

# Disable fb_only_network
INHERIT_remove = "fb-only-network"
```

## meta-facebook/meta-lightning/conf/machine/lightning.conf
```bitbake
#@TYPE: Machine
#@NAME: Lightning
#@DESCRIPTION: Machine configuration for Facebook Lightning

UBOOT_MACHINE_lightning = "fblightning_config"

require conf/machine/include/ast1250.inc

PREFERRED_VERSION_u-boot = "v2016.07"
PREFERRED_VERSION_u-boot-mkimage = "v2016.07"
PREFERRED_VERSION_u-boot-fw-utils = "v2016.07"
PREFERRED_VERSION_fscd = "0.3"
PREFERRED_VERSION_openbmc-gpio = "0.2"
KERNEL_IMAGETYPE = "zImage"
PREFERRED_VERSION_rest-api = "0.2"
PREFERRED_VERSION_libwatchdog = "0.1"
```

## meta-facebook/meta-minerva/conf/layer.conf
```bitbake
# We have a conf and classes directory, add to BBPATH
BBPATH .= ":${LAYERDIR}"

# We have recipes-* directories, add to BBFILES
BBFILES += "${LAYERDIR}/recipes-*/*/*.bb \
            ${LAYERDIR}/recipes-*/*/*.bbappend"

BBFILE_COLLECTIONS += "fb-minerva-layer"
BBFILE_PATTERN_fb-minerva-layer := "^${LAYERDIR}/"

LAYERSERIES_COMPAT_fb-minerva-layer := "scarthgap nanbield kirkstone"
```

## meta-facebook/meta-minilaketb/conf/layer.conf
```bitbake
# We have a conf and classes directory, add to BBPATH
BBPATH .= ":${LAYERDIR}"

# We have recipes-* directories, add to BBFILES
BBFILES += "${LAYERDIR}/recipes-*/*/*.bb \
	${LAYERDIR}/recipes-*/*/*.bbappend"

BBFILE_COLLECTIONS += "minilaketb"
BBFILE_PATTERN_minilaketb = "^${LAYERDIR}/"
BBFILE_PRIORITY_minilaketb = "20"
```

## meta-facebook/meta-minilaketb/conf/machine/minilaketb.conf
```bitbake
#@TYPE: Machine
#@NAME: minilaketb
#@DESCRIPTION: Machine configuration for Facebook minilaketb

UBOOT_MACHINE_minilaketb = "minilaketb_config"

PREFERRED_VERSION_u-boot = "v2016.07"
PREFERRED_VERSION_u-boot-mkimage = "v2016.07"
PREFERRED_VERSION_u-boot-fw-utils = "v2016.07"
PREFERRED_VERSION_bios-util = "0.2"
PREFERRED_VERSION_libwatchdog = "0.1"
PREFERRED_VERSION_libbic = "0.1"
PREFERRED_VERSION_bic-util = "0.1"
PREFERRED_VERSION_libpal = "0.2"

KERNEL_IMAGETYPE = "zImage"

require conf/machine/include/ast2520.inc

# configuration for preferred version of packages
```

## meta-facebook/meta-minipack/conf/layer.conf
```bitbake
# We have a conf and classes directory, add to BBPATH
BBPATH .= ":${LAYERDIR}"

# We have recipes-* directories, add to BBFILES
BBFILES += "${LAYERDIR}/recipes-*/*/*.bb \
	${LAYERDIR}/recipes-*/*/*.bbappend"

BBFILE_COLLECTIONS += "minipack"
BBFILE_PATTERN_minipack = "^${LAYERDIR}/"
BBFILE_PRIORITY_minipack = "25"
LAYERSERIES_COMPAT_minipack = "zeus warrior rocko"
```

## meta-facebook/meta-minipack/conf/local.conf.sample
```bitbake
#
# Local configuration file for building the OpenBMC image.
#

# Machine Selection
MACHINE ??= "minipack"

# OpenBMC distro settings
DISTRO ?= "openbmc-fb"
```

## meta-facebook/meta-minipack/conf/machine/minipack.conf
```bitbake
#@TYPE: Machine
#@NAME: Minipack
#@DESCRIPTION: Machine configuration for Facebook Minipack

require conf/machine/include/ast2520.inc
require conf/machine/include/fb-fboss.inc
require conf/machine/include/mtd-ubifs.inc
require conf/machine/include/tpm1.inc

UBOOT_MACHINE:minipack = "fbminipack_config"
KERNEL_IMAGETYPE = "zImage"

#
# Kernel version.
#
KERNEL_DEVICETREE = "aspeed-bmc-facebook-minipack.dtb"
PREFERRED_VERSION_linux-aspeed = "6.0.%"

#
# U-boot version.
#
PREFERRED_VERSION_u-boot = "v2019.04%"
PREFERRED_VERSION_u-boot-mkimage = "v2019.04%"
PREFERRED_VERSION_u-boot-mkimage-native = "v2019.04%"
PREFERRED_VERSION_nativesdk-u-boot-mkimage = "v2019.04%"
PREFERRED_VERSION_u-boot-fw-utils = "v2019.04%"
PREFERRED_VERSION_u-boot-fw-utils-cross = "v2019.04%"

#
# Preferred version of user space packages.
#
PREFERRED_VERSION_libipmi = "0.2"
PREFERRED_VERSION_ipmid = "0.2"
PREFERRED_VERSION_rest-api = "0.1"
PREFERRED_VERSION_at93cx6-util = "0.1"
PREFERRED_VERSION_bcm5396-util = "0.1"
PREFERRED_VERSION_fscd = "0.3"
PREFERRED_VERSION_openbmc-gpio = "0.2"
PREFERRED_VERSION_libbic = "0.2"
PREFERRED_VERSION_bic-util = "0.2"

MACHINE_ESSENTIAL_EXTRA_RDEPENDS += "           \
    kernel-module-i2c-dev-sysfs                 \
    kernel-module-cpld                          \
    kernel-module-i2c                           \
    "

MACHINE_FEATURES += "emmc emmc-ext4"
```

## meta-facebook/meta-morgan800cc/conf/layer.conf
```bitbake
# Copyright (c) Meta Platforms, Inc. and affiliates.
#
# This program file is free software; you can redistribute it and/or modify it
# under the terms of the GNU General Public License as published by the
# Free Software Foundation; version 2 of the License.
#
# This program is distributed in the hope that it will be useful, but WITHOUT
# ANY WARRANTY; without even the implied warranty of MERCHANTABILITY or
# FITNESS FOR A PARTICULAR PURPOSE.  See the GNU General Public License
# for more details.
#
# You should have received a copy of the GNU General Public License
# along with this program in a file named COPYING; if not, write to the
# Free Software Foundation, Inc.,
# 51 Franklin Street, Fifth Floor,
# Boston, MA 02110-1301 USA

BBPATH .= ":${LAYERDIR}"

# We have recipes-* directories, add to BBFILES
BBFILES += "${LAYERDIR}/recipes-*/*/*.bb \
            ${LAYERDIR}/recipes-*/*/*.bbappend"

BBFILE_COLLECTIONS += "morgan800cc"
BBFILE_PATTERN_morgan800cc = "^${LAYERDIR}/"
BBFILE_PRIORITY_morgan800cc = "25"

LAYERSERIES_COMPAT_morgan800cc = "mickledore kirkstone dunfell"

DISTRO_FEATURES:append = " systemd usrmerge"
VIRTUAL-RUNTIME_init_manager = "systemd"
DISTRO_FEATURES_BACKFILL_CONSIDERED += "sysvinit"
VIRTUAL-RUNTIME_initscripts = "systemd-compat-units"
```

## meta-facebook/meta-netlakemtp/conf/layer.conf
```bitbake
# We have a conf and classes directory, add to BBPATH
BBPATH .= ":${LAYERDIR}"

# We have recipes-* directories, add to BBFILES
BBFILES += "${LAYERDIR}/recipes-*/*/*.bb \
	${LAYERDIR}/recipes-*/*/*.bbappend"

BBFILE_COLLECTIONS += "netlakemtp"
BBFILE_PATTERN_netlakemtp = "^${LAYERDIR}/"
BBFILE_PRIORITY_netlakemtp = "20"

LAYERSERIES_COMPAT_netlakemtp = "kirkstone honister dunfell"
```

## meta-facebook/meta-netlakemtp/conf/local.conf.sample
```bitbake
#
# Local configuration file for building the OpenBMC image.
#

# Machine Selection
MACHINE ??= "netlakemtp"

# OpenBMC distro settings
DISTRO ?= "openbmc-fb"
```

## meta-facebook/meta-netlakemtp/conf/machine/netlakemtp.conf
```bitbake
#@TYPE: Machine
#@NAME: NetLakeMTP
#@DESCRIPTION: Machine configuration for Facebook NetLakeMTP

require conf/machine/include/ast2620.inc
require conf/machine/include/mtd-ubifs.inc
require conf/machine/include/tpm2.inc

KERNEL_IMAGETYPE = "zImage"
UBOOT_MACHINE:netlakemtp = "facebook-netlakemtp_defconfig"
UBOOT_CONFIG_BASE = "fbobmc-ast-g6_defconfig"

KERNEL_DEVICETREE = "aspeed-bmc-facebook-netlakemtp.dtb"
PREFERRED_VERSION_linux-aspeed = "5.10.%"

PREFERRED_VERSION_u-boot = "v2019.04"
PREFERRED_VERSION_u-boot-tools = "v2019.04"
PREFERRED_VERSION_u-boot-tools-native = "v2019.04"
PREFERRED_VERSION_nativesdk-u-boot-tools = "v2019.04"
PREFERRED_VERSION_u-boot-fw-utils = "v2019.04"
PREFERRED_VERSION_u-boot-fw-utils-cross = "v2019.04"

PREFERRED_VERSION_libwatchdog = "0.2"

PREFERRED_VERSION_bios-util = "0.2"
PREFERRED_VERSION_asd = "1.4.3"

MACHINE_ESSENTIAL_EXTRA_RDEPENDS += "           \
    "

EXTRA_IMAGE_FEATURES_append = " verified-boot image-meta"
FW_ENV_CONFIG_FILE = "fw_env.config.64k"
```

## meta-facebook/meta-python3/conf/layer.conf
```bitbake
# We have a conf and classes directory, add to BBPATH
BBPATH .= ":${LAYERDIR}"

# We have recipes-* directories, add to BBFILES
BBFILES += "${LAYERDIR}/recipes-*/*/*.bb \
        ${LAYERDIR}/recipes-*/*/*.bbappend"

BBFILE_COLLECTIONS += "py3"
BBFILE_PATTERN_py3 = "^${LAYERDIR}/"
# Top priority, append over all else
BBFILE_PRIORITY_py3 = "99"

LAYERSERIES_COMPAT_py3 = "kirkstone dunfell rocko"
```

## meta-facebook/meta-qemux86/conf/layer.conf
```bitbake
# We have a conf and classes directory, add to BBPATH
BBPATH .= ":${LAYERDIR}"

# We have recipes-* directories, add to BBFILES
BBFILES += "${LAYERDIR}/recipes-*/*/*.bb \
	${LAYERDIR}/recipes-*/*/*.bbappend"

BBFILE_COLLECTIONS += "qemux86"
BBFILE_PATTERN_qemux86 = "^${LAYERDIR}/"
BBFILE_PRIORITY_qemux86 = "20"

LAYERSERIES_COMPAT_qemux86 = "mickledore langdale kirkstone dunfell"
```

## meta-facebook/meta-qemux86/conf/local.conf.sample
```bitbake
#
# Local configuration file for building the OpenBMC image.
#

# Machine Selection
MACHINE ??= "qemux86-64"

# Do not build kernel since we are doing a chroot to execute
# the binaries in the image.
PREFERRED_PROVIDER_virtual/kernel = "linux-dummy"
PREFERRED_VERSION_libpal = "0.2"

# OpenBMC distro settings
DISTRO ?= "openbmc-fb"

# Enable ptest to be built into the image.
DISTRO_FEATURES_append = " ptest"
```

## meta-facebook/meta-sandia/conf/layer.conf
```bitbake
# We have a conf and classes directory, add to BBPATH
BBPATH .= ":${LAYERDIR}"

FB_PROPRIETARY_RECIPES:fb-proprietary-recipes = " \
    ${LAYERDIR}/../../proprietary/cisco/meta-cisco/recipes-*/*/*.bb \
    ${LAYERDIR}/../../proprietary/cisco/meta-cisco/recipes-*/*/*.bbappend \
    ${LAYERDIR}/../../proprietary/cisco/meta-sandia/recipes-*/*/*.bb \
    ${LAYERDIR}/../../proprietary/cisco/meta-sandia/recipes-*/*/*.bbappend \
    "

# We have recipes-* directories, add to BBFILES
BBFILES += "\
    ${LAYERDIR}/recipes-*/*/*.bb \
    ${LAYERDIR}/recipes-*/*/*.bbappend \
    ${FB_PROPRIETARY_RECIPES} \
    "

BBFILE_COLLECTIONS += "sandia"
BBFILE_PATTERN_sandia = "^${LAYERDIR}/"
BBFILE_PRIORITY_sandia = "25"

LAYERSERIES_COMPAT_sandia = "mickledore langdale kirkstone dunfell"

DISTRO_FEATURES:append = " systemd"
VIRTUAL-RUNTIME_init_manager = "systemd"

LICENSE_PATH:fb-proprietary-recipes += "${LAYERDIR}/../../proprietary/cisco/meta-cisco/custom-licenses"
COMPANY_COMMON_LICENSES:fb-proprietary-recipes := '${@os.path.normpath("${LAYERDIR}/../../proprietary/cisco/meta-cisco/custom-licenses")}'
```

## meta-facebook/meta-sandia/conf/machine/sandia.conf
```bitbake
#@TYPE: Machine
#@NAME: Sandia
#@DESCRIPTION: Machine configuration for Facebook Sandia

require conf/machine/fboss-lite.inc
require conf/machine/include/runqemu.inc

UBOOT_MACHINE:sandia = "facebook-sandia_defconfig"

KERNEL_DEVICETREE = "aspeed-bmc-facebook-sandia.dtb"
PREFERRED_VERSION_linux-aspeed = "5.15.%"
```

## meta-facebook/meta-tahan/conf/machine/tahan.conf
```bitbake
# Copyright (c) Meta Platforms, Inc. and affiliates.
#
# This program file is free software; you can redistribute it and/or modify it
# under the terms of the GNU General Public License as published by the
# Free Software Foundation; version 2 of the License.
#
# This program is distributed in the hope that it will be useful, but WITHOUT
# ANY WARRANTY; without even the implied warranty of MERCHANTABILITY or
# FITNESS FOR A PARTICULAR PURPOSE.  See the GNU General Public License
# for more details.
#
# You should have received a copy of the GNU General Public License
# along with this program in a file named COPYING; if not, write to the
# Free Software Foundation, Inc.,
# 51 Franklin Street, Fifth Floor,
# Boston, MA 02110-1301 USA

#@TYPE: Machine
#@NAME: tahan
#@DESCRIPTION: Machine configuration for Facebook tahan

require conf/machine/fboss-lite.inc

UBOOT_MACHINE:tahan = "facebook-fblite_defconfig"

KERNEL_DEVICETREE = "aspeed-bmc-facebook-tahan.dtb"
PREFERRED_VERSION_linux-aspeed = "6.1.%"

MACHINE_ESSENTIAL_EXTRA_RDEPENDS += "kernel-module-cpld"
```

## meta-facebook/meta-ventura/conf/layer.conf
```bitbake
# We have a conf and classes directory, add to BBPATH
BBPATH .= ":${LAYERDIR}"

# We have recipes-* directories, add to BBFILES
BBFILES += "${LAYERDIR}/recipes-*/*/*.bb \
            ${LAYERDIR}/recipes-*/*/*.bbappend"

BBFILE_COLLECTIONS += "fb-ventura-layer"
BBFILE_PATTERN_fb-ventura-layer := "^${LAYERDIR}/"

LAYERSERIES_COMPAT_fb-ventura-layer := "scarthgap nanbield kirkstone"
```

## meta-facebook/meta-waimeacanyon/conf/layer.conf
```bitbake
# We have a conf and classes directory, add to BBPATH
BBPATH .= ":${LAYERDIR}"

# We have recipes-* directories, add to BBFILES
BBFILES += "${LAYERDIR}/recipes-*/*/*.bb \
	${LAYERDIR}/recipes-*/*/*.bbappend"

BBFILE_COLLECTIONS += "waimeacanyon"
BBFILE_PATTERN_waimeacanyon = "^${LAYERDIR}/"
BBFILE_PRIORITY_waimeacanyon = "20"

LAYERSERIES_COMPAT_waimeacanyon = "mickledore langdale kirkstone"
```

## meta-facebook/meta-wedge/conf/bblayers.conf.sample
```bitbake
# LAYER_CONF_VERSION is increased each time build/conf/bblayers.conf
# changes incompatibly
LCONF_VERSION = "6"

BBPATH = "${TOPDIR}"
BBFILES ?= ""

BBLAYERS ?= " \
  ##OEROOT##/meta \
  ##OEROOT##/meta-poky \
  ##OEROOT##/meta-yocto-bsp \
  ##OEROOT##/../meta-openembedded/meta-oe \
  ##OEROOT##/../meta-openembedded/meta-networking \
  ##OEROOT##/../meta-openembedded/meta-python \
  ##OEROOT##/../../.. \
  ##OEROOT##/../../../meta-aspeed \
  ##OEROOT##/../../../meta-facebook \
  ##OEROOT##/../../../meta-facebook/meta-wedge \
  ##OEROOT##/../../../meta-facebook/meta-python3 \
  "
BBLAYERS_NON_REMOVABLE ?= " \
  ##OEROOT##/meta \
  ##OEROOT##/meta-poky \
  "
```

## meta-facebook/meta-wedge/conf/layer.conf
```bitbake
# We have a conf and classes directory, add to BBPATH
BBPATH .= ":${LAYERDIR}"

# We have recipes-* directories, add to BBFILES
BBFILES += "${LAYERDIR}/recipes-*/*/*.bb \
	${LAYERDIR}/recipes-*/*/*.bbappend"

BBFILE_COLLECTIONS += "wedge"
BBFILE_PATTERN_wedge = "^${LAYERDIR}/"
BBFILE_PRIORITY_wedge = "20"
```
