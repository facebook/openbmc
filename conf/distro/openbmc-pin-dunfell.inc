## conf/distro/openbmc-pin-rocko.inc
```bitbake
PREFERRED_VERSION_aiohttp = "2.1.0"
PREFERRED_VERSION_aiohttp-native = "2.1.0"

PREFERRED_VERSION_async-timeout = "1.2.1"
PREFERRED_VERSION_async-timeout-native = "1.2.1"

PREFERRED_VERSION_chardet = "3.0.4"
PREFERRED_VERSION_chardet-native = "3.0.4"

PREFERRED_VERSION_yarl = "0.10.3"
PREFERRED_VERSION_yarl-native = "0.10.3"

PREFERRED_VERSION_multidict = "2.1.6"
PREFERRED_VERSION_multidict-native = "2.1.6"
```

## conf/distro/openbmc-yocto-dunfell.inc
```bitbake
# Prior to Honister, the licenses like GPL-2.0-only didn't exist and only
# the non-timed versions did, but these non-timed versions are now deprecated
# in Kirkstone.  We need our recipes to have the timed versions so that they
# are compatible with Kirkstone, but we need to provide mappings for old:
# distros in order to avoid missing license warnings.
SPDXLICENSEMAP[GPL-2.0-only] = "GPL-2.0"
SPDXLICENSEMAP[GPL-2.0-or-later] = "GPL-2.0"
SPDXLICENSEMAP[LGPL-2.1-only] = "LGPL-2.1"
SPDXLICENSEMAP[LGPL-2.1-or-later] = "LGPL-2.1"

require conf/distro/openbmc-pin-dunfell.inc
```

## conf/layer.conf
```bitbake
# We have a conf and classes directory, add to BBPATH
BBPATH .= ":${LAYERDIR}"

# We have common/recipes-* directories, add to BBFILES
BBFILES += "\
  ${LAYERDIR}/common/recipes-*/*/*.bb \
	${LAYERDIR}/common/recipes-*/*/*.bbappend \
  "

# Facebook internal common recipes
# NOTICE:
#   order is matter bitbake apply bbappend in order
#   listed here, so keep internal recipes in last
#   to make sure it is applied last
BBFILES += "\
	${LAYERDIR}/common/facebook/recipes-*/*/*.bb \
	${LAYERDIR}/common/facebook/recipes-*/*/*.bbappend \
  "
#   Any proprietary code.
BBFILES += "\
	${LAYERDIR}/proprietary/*/*/*.bb \
	${LAYERDIR}/proprietary/*/*/*.bbappend \
  "

BBFILE_COLLECTIONS += "openbmc"
BBFILE_PATTERN_openbmc = "^${LAYERDIR_RE}/common/(recipes|facebook)"
BBFILE_PRIORITY_openbmc = "6"

LAYERSERIES_COMPAT_openbmc = "kirkstone honister dunfell rocko"

INHERIT += "local-source"
```

## meta-aspeed/conf/distro/include/tclibc-eglibc.inc
```bitbake
#
# eglibc specific configuration
#

LIBCEXTENSION = "${@['', '-gnu'][(d.getVar('ABIEXTENSION', True) or '') != '']}"

# Add glibc overrides to the overrides for eglibc.
LIBCOVERRIDE = ":libc-glibc"
OVERRIDES .= "${LIBCOVERRIDE}"

PREFERRED_PROVIDER_virtual/libiconv ?= "eglibc"
PREFERRED_PROVIDER_virtual/nativesdk-libiconv ?= "nativesdk-eglibc"
PREFERRED_PROVIDER_virtual/nativesdk-libintl ?= "nativesdk-eglibc"
PREFERRED_PROVIDER_virtual/libintl ?= "eglibc"
PREFERRED_PROVIDER_virtual/libc ?= "eglibc"
PREFERRED_PROVIDER_virtual/nativesdk-libc ?= "nativesdk-eglibc"
PREFERRED_PROVIDER_virtual/libc-locale ?= "eglibc-locale"

CXXFLAGS += "-fvisibility-inlines-hidden"

LIBC_DEPENDENCIES = "libsegfault \
		     eglibc \
		     eglibc-dbg \
		     eglibc-dev \
		     eglibc-utils \
		     eglibc-thread-db \
		     ${@get_libc_locales_dependencies(d)}"

LIBC_LOCALE_DEPENDENCIES = "\
	eglibc-localedata-i18n \
	eglibc-gconv-ibm850 \
	eglibc-gconv-cp1252 \
	eglibc-gconv-iso8859-1 \
	eglibc-gconv-iso8859-15"

def get_libc_locales_dependencies(d):
    if 'libc-locales' in (d.getVar('DISTRO_FEATURES', True) or '').split() :
        return d.getVar('LIBC_LOCALE_DEPENDENCIES', True) or ''
    else:
        return ''
```

## meta-aspeed/conf/machine/include/ast1250.inc
```bitbake
#@TYPE: Machine
#@NAME: aspeed ast1250
#@DESCRIPTION: Machine configuration for aspeed ast1250 SoC

# Ship all kernel modules by default
MACHINE_EXTRA_RRECOMMENDS = "kernel-modules"

# Allow for MMC booting (required by the NAND-less Beagleboard XM)
EXTRA_IMAGEDEPENDS += "u-boot"

# Uncomment the following line to enable the hard floating point abi. Note that
# this breaks some binary libraries and 3D (neither of which ship with
# meta-yocto). For maximum compatibility, leave this disabled.
require conf/machine/include/tune-arm926ejs.inc

PREFERRED_PROVIDER_virtual/kernel ?= "linux-aspeed"
PREFERRED_VERSION_linux-aspeed ?= "4.1.51"

PREFERRED_VERSION_u-boot ?= "v2016.07"
PREFERRED_VERSION_u-boot-fw-utils ?= "v2016.07"

KERNEL_IMAGETYPE ?= "uImage"
KERNEL_EXTRA_ARGS ?= "UIMAGE_LOADADDR=0x40008000"

UBOOT_SUFFIX ?= "bin"
UBOOT_ENTRYPOINT ?= "0x40008000"
UBOOT_LOADADDRESS ?= "0x40008000"
UBOOT_MACHINE ?= "ast1250_config"

MACHINE_FEATURES = "usbgadget usbhost vfat ext2 serial"
```

## meta-aspeed/conf/machine/include/ast2400.inc
```bitbake
#@TYPE: Machine
#@NAME: aspeed ast2400
#@DESCRIPTION: Machine configuration for aspeed ast2400 SoC

UBOOT_MACHINE ?= "ast2400_config"

require conf/machine/include/ast1250.inc
```

## meta-aspeed/conf/machine/include/ast2520.inc
```bitbake
#@TYPE: Machine
#@NAME: Aspeed AST2520
#@DESCRIPTION: Machine configuration for Aspeed AST2520 SoC

# Ship all kernel modules by default
MACHINE_EXTRA_RRECOMMENDS = "kernel-modules"

EXTRA_IMAGEDEPENDS += "u-boot"

# Uncomment the following line to enable the hard floating point abi. Note that
# this breaks some binary libraries and 3D (neither of which ship with
# meta-yocto). For maximum compatibility, leave this disabled.
DEFAULTTUNE ?= "armv6-novfp"
require conf/machine/include/tune-arm1136jf-s.inc

PREFERRED_PROVIDER_virtual/kernel ?= "linux-aspeed"

# We have 2 kernel trees to pick from
PREFERRED_VERSION_linux-aspeed ?= "4.1.51"
#PREFERRED_VERSION_linux-aspeed ?= "4.7"

PREFERRED_VERSION_u-boot ?= "v2016.07"
PREFERRED_VERSION_u-boot-fw-utils ?= "v2016.07"

KERNEL_IMAGETYPE ?= "uImage"
KERNEL_EXTRA_ARGS ?= "UIMAGE_LOADADDR=0x80008000"

UBOOT_SUFFIX ?= "bin"
UBOOT_ENTRYPOINT ?= "0x80008000"
UBOOT_LOADADDRESS ?= "0x80008000"
UBOOT_MACHINE ?= "ast-g5_config"

MACHINE_FEATURES = "usbgadget usbhost vfat ext2 serial"
```

## meta-aspeed/conf/machine/include/ast2620.inc
```bitbake
#@TYPE: Machine
#@NAME: Aspeed AST2620
#@DESCRIPTION: Machine configuration for Aspeed AST2620 SoC

SOC_MODEL ?= "ast2620"
SOC_FAMILY = "aspeed-g6"

include conf/machine/include/soc-family.inc
include conf/machine/include/arm/arch-armv7a.inc

# Ship all kernel modules by default
MACHINE_EXTRA_RRECOMMENDS = "kernel-modules"

EXTRA_IMAGEDEPENDS += "u-boot"

DEFAULTTUNE ?= "armv7a-vfpv4d16"
PREFERRED_PROVIDER_virtual/kernel ?= "linux-aspeed"

PREFERRED_VERSION_linux-aspeed ?= "5.3.8"

PREFERRED_VERSION_u-boot ?= "v2019.04"
PREFERRED_VERSION_u-boot-tools ?= "v2019.04"
PREFERRED_VERSION_u-boot-fw-utils ?= "v2019.04"

KERNEL_IMAGETYPE ?= "zImage"
KERNEL_EXTRA_ARGS ?= "UIMAGE_LOADADDR=0x80008000"

UBOOT_SUFFIX ?= "bin"
UBOOT_ENTRYPOINT ?= "0x80008000"
UBOOT_LOADADDRESS ?= "0x80008000"
UBOOT_MACHINE ?= "ast-g6_config"
```

## meta-aspeed/conf/machine/include/tune-arm1136jf-s.inc
```bitbake
# Honister and later distros move this file to a subdirectory so add a redirect.
# Older distros will find the original file in poky/meta first.
require conf/machine/include/arm/armv6/tune-arm1136jf-s.inc
```

## meta-aspeed/conf/machine/include/tune-arm926ejs.inc
```bitbake
# Honister and later distros move this file to a subdirectory so add a redirect.
# Older distros will find the original file in poky/meta first.
require conf/machine/include/arm/armv5/tune-arm926ejs.inc
```

## meta-aspeed/recipes-kernel/linux/files/defconfig-5.15/ast2620/defconfig
```kconfig
#
# AST2600 defconfig
#
CONFIG_KERNEL_XZ=y
CONFIG_SYSVIPC=y
CONFIG_NO_HZ_IDLE=y
CONFIG_HIGH_RES_TIMERS=y
CONFIG_PSI=y
CONFIG_PSI_DEFAULT_DISABLED=y
CONFIG_IKCONFIG=y
CONFIG_IKCONFIG_PROC=y
CONFIG_LOG_BUF_SHIFT=16
CONFIG_CGROUPS=y
CONFIG_BLK_DEV_INITRD=y
CONFIG_BPF_SYSCALL=y
CONFIG_EMBEDDED=y
CONFIG_PERF_EVENTS=y
CONFIG_SLAB=y
CONFIG_SLAB_FREELIST_RANDOM=y
CONFIG_ARCH_MULTI_V6=y
CONFIG_ARCH_ASPEED=y
CONFIG_MACH_ASPEED_G6=y
CONFIG_SMP=y
CONFIG_VMSPLIT_2G=y
CONFIG_NR_CPUS=2
CONFIG_HIGHMEM=y
CONFIG_UACCESS_WITH_MEMCPY=y
CONFIG_SECCOMP=y
CONFIG_ZBOOT_ROM_TEXT=0x0
CONFIG_ZBOOT_ROM_BSS=0x0
CONFIG_KEXEC=y
CONFIG_VFP=y
CONFIG_NEON=y
CONFIG_KERNEL_MODE_NEON=y
CONFIG_FIRMWARE_MEMMAP=y
CONFIG_JUMP_LABEL=y
CONFIG_NET=y
CONFIG_PACKET=y
CONFIG_PACKET_DIAG=y
CONFIG_UNIX=y
CONFIG_UNIX_DIAG=y
CONFIG_INET=y
CONFIG_IP_MULTICAST=y
CONFIG_IP_ADVANCED_ROUTER=y
CONFIG_IP_MULTIPLE_TABLES=y
CONFIG_IP_ROUTE_MULTIPATH=y
CONFIG_IP_ROUTE_VERBOSE=y
CONFIG_SYN_COOKIES=y
CONFIG_IPV6_ROUTER_PREF=y
CONFIG_IPV6_ROUTE_INFO=y
CONFIG_IPV6_OPTIMISTIC_DAD=y
CONFIG_IPV6_MULTIPLE_TABLES=y
CONFIG_NETFILTER=y
CONFIG_VLAN_8021Q=y
CONFIG_NET_NCSI=y
CONFIG_NCSI_OEM_CMD_GET_MAC=y
CONFIG_DEVTMPFS=y
CONFIG_DEVTMPFS_MOUNT=y
CONFIG_MTD=y
CONFIG_MTD_BLOCK=y
CONFIG_MTD_SPI_NOR=y
CONFIG_SPI_ASPEED_SMC=y
CONFIG_MTD_UBI=y
CONFIG_MTD_UBI_FASTMAP=y
CONFIG_MTD_UBI_BLOCK=y
CONFIG_BLK_DEV_LOOP=y
CONFIG_BLK_DEV_NBD=y
CONFIG_EEPROM_AT24=y
CONFIG_MD=y
CONFIG_BLK_DEV_DM=y
CONFIG_DM_VERITY=y
CONFIG_NETDEVICES=y
CONFIG_NETCONSOLE=y
CONFIG_FTGMAC100=y
CONFIG_BROADCOM_PHY=y
CONFIG_REALTEK_PHY=y
CONFIG_INPUT_EVDEV=y
CONFIG_KEYBOARD_GPIO=y
CONFIG_KEYBOARD_GPIO_POLLED=y
CONFIG_SERIAL_8250=y
CONFIG_SERIAL_8250_CONSOLE=y
CONFIG_SERIAL_8250_NR_UARTS=17
CONFIG_SERIAL_8250_RUNTIME_UARTS=17
CONFIG_SERIAL_8250_EXTENDED=y
CONFIG_SERIAL_8250_ASPEED_VUART=y
CONFIG_SERIAL_8250_SHARE_IRQ=y
CONFIG_SERIAL_8250_DW=y
CONFIG_SERIAL_OF_PLATFORM=y
CONFIG_ASPEED_KCS_IPMI_BMC=y
CONFIG_ASPEED_BT_IPMI_BMC=y
CONFIG_HW_RANDOM_TIMERIOMEM=y
CONFIG_I2C_CHARDEV=y
CONFIG_I2C_MUX=y
CONFIG_I2C_MUX_PCA9541=y
CONFIG_I2C_MUX_PCA954x=y
CONFIG_I2C_ASPEED=y
CONFIG_I2C_FSI=y
CONFIG_SPI=y
CONFIG_GPIOLIB=y
CONFIG_GPIO_SYSFS=y
CONFIG_GPIO_ASPEED=y
CONFIG_GPIO_PCA953X=y
CONFIG_GPIO_PCA953X_IRQ=y
CONFIG_W1=y
CONFIG_W1_MASTER_GPIO=y
CONFIG_W1_SLAVE_THERM=y
CONFIG_SENSORS_ASPEED=y
CONFIG_SENSORS_IIO_HWMON=y
CONFIG_SENSORS_LM75=y
CONFIG_SENSORS_NCT7904=y
CONFIG_SENSORS_OCC_P8_I2C=y
CONFIG_SENSORS_OCC_P9_SBE=y
CONFIG_SENSORS_PECI_CPUTEMP=y
CONFIG_SENSORS_PECI_DIMMTEMP=y
CONFIG_SENSORS_ADM1275=y
CONFIG_SENSORS_IBM_CFFPS=y
CONFIG_SENSORS_IR35221=y
CONFIG_SENSORS_IR38064=y
CONFIG_SENSORS_ISL68137=y
CONFIG_SENSORS_LM25066=y
CONFIG_SENSORS_MAX31785=y
CONFIG_SENSORS_UCD9000=y
CONFIG_SENSORS_UCD9200=y
CONFIG_SENSORS_TMP421=y
CONFIG_SENSORS_W83773G=y
CONFIG_WATCHDOG_SYSFS=y
CONFIG_MEDIA_SUPPORT=y
CONFIG_MEDIA_CAMERA_SUPPORT=y
CONFIG_V4L_PLATFORM_DRIVERS=y
CONFIG_VIDEO_ASPEED=y
CONFIG_DRM=y
CONFIG_DRM_ASPEED_GFX=y
CONFIG_USB=y
CONFIG_USB_ANNOUNCE_NEW_DEVICES=y
CONFIG_USB_DYNAMIC_MINORS=y
CONFIG_USB_EHCI_HCD=y
CONFIG_USB_EHCI_ROOT_HUB_TT=y
CONFIG_USB_EHCI_HCD_PLATFORM=y
CONFIG_USB_GADGET=y
CONFIG_USB_ASPEED_VHUB=y
CONFIG_USB_CONFIGFS_MASS_STORAGE=y
CONFIG_USB_CONFIGFS_F_HID=y
CONFIG_MMC=y
CONFIG_MMC_SDHCI=y
CONFIG_MMC_SDHCI_PLTFM=y
CONFIG_MMC_SDHCI_OF_ASPEED=y
CONFIG_NEW_LEDS=y
CONFIG_LEDS_CLASS=y
CONFIG_LEDS_CLASS_FLASH=y
CONFIG_LEDS_GPIO=y
CONFIG_LEDS_PCA955X=y
CONFIG_LEDS_PCA955X_GPIO=y
CONFIG_LEDS_TRIGGERS=y
CONFIG_LEDS_TRIGGER_TIMER=y
CONFIG_LEDS_TRIGGER_HEARTBEAT=y
CONFIG_LEDS_TRIGGER_DEFAULT_ON=y
CONFIG_EDAC=y
CONFIG_EDAC_ASPEED=y
CONFIG_RTC_CLASS=y
CONFIG_RTC_DRV_DS1307=y
CONFIG_RTC_DRV_PCF8523=y
CONFIG_RTC_DRV_RV8803=y
CONFIG_RTC_DRV_ASPEED=y
CONFIG_ASPEED_LPC_CTRL=y
CONFIG_ASPEED_LPC_SNOOP=y
CONFIG_ASPEED_P2A_CTRL=y
CONFIG_IIO=y
CONFIG_ASPEED_ADC=y
CONFIG_MAX1363=y
CONFIG_BMP280=y
CONFIG_DPS310=y
CONFIG_RAS=y
CONFIG_FSI=y
CONFIG_FSI_MASTER_HUB=y
CONFIG_FSI_MASTER_ASPEED=y
CONFIG_FSI_SCOM=y
CONFIG_FSI_SBEFIFO=y
CONFIG_FSI_OCC=y
CONFIG_PECI=y
CONFIG_PECI_ASPEED=y
CONFIG_FANOTIFY=y
CONFIG_OVERLAY_FS=y
CONFIG_TMPFS=y
CONFIG_JFFS2_FS=y
CONFIG_UBIFS_FS=y
CONFIG_SQUASHFS=y
CONFIG_SQUASHFS_XZ=y
CONFIG_SQUASHFS_ZSTD=y
CONFIG_HARDENED_USERCOPY=y
CONFIG_FORTIFY_SOURCE=y
CONFIG_CRYPTO_HMAC=y
CONFIG_CRYPTO_SHA256=y
CONFIG_CRYPTO_USER_API_HASH=y
CONFIG_PRINTK_TIME=y
CONFIG_DYNAMIC_DEBUG=y
CONFIG_DEBUG_INFO=y
CONFIG_DEBUG_INFO_REDUCED=y
CONFIG_DEBUG_INFO_DWARF4=y
CONFIG_GDB_SCRIPTS=y
CONFIG_STRIP_ASM_SYMS=y
CONFIG_SOFTLOCKUP_DETECTOR=y
CONFIG_BOOTPARAM_SOFTLOCKUP_PANIC=y
CONFIG_BOOTPARAM_HUNG_TASK_PANIC=y
CONFIG_WQ_WATCHDOG=y
CONFIG_PANIC_ON_OOPS=y
CONFIG_PANIC_TIMEOUT=-1
CONFIG_SCHED_STACK_END_CHECK=y
CONFIG_FUNCTION_TRACER=y
CONFIG_DEBUG_WX=y
CONFIG_DEBUG_USER=y

#
# Common config for facebook bmc platforms.
#
CONFIG_POSIX_MQUEUE=y
CONFIG_MODULES=y
CONFIG_MODULE_FORCE_LOAD=y
CONFIG_MODULE_UNLOAD=y
CONFIG_MODULE_FORCE_UNLOAD=y
CONFIG_BLK_SCSI_REQUEST=y
CONFIG_MTD_CMDLINE_PARTS=y
CONFIG_MTD_PARTITIONED_MASTER=n
CONFIG_SCSI=y
CONFIG_BLK_DEV_SD=y
CONFIG_EXT4_FS=m
CONFIG_BTRFS_FS=m
CONFIG_VT=y
CONFIG_LEGACY_PTYS=y
CONFIG_I2C_SLAVE=y
CONFIG_SPI_SPIDEV=y
CONFIG_PMBUS=y
CONFIG_SENSORS_PMBUS=y
CONFIG_DEVKMEM=y

#
# USB options, mainly for USB gadget
#
CONFIG_USB_STORAGE=m
CONFIG_USB_LIBCOMPOSITE=m
CONFIG_USB_F_ACM=m
CONFIG_USB_U_SERIAL=m
CONFIG_USB_U_ETHER=m
CONFIG_USB_F_SERIAL=m
CONFIG_USB_F_NCM=m
CONFIG_USB_F_ECM=m
CONFIG_USB_F_EEM=m
CONFIG_USB_F_SUBSET=m
CONFIG_USB_F_RNDIS=m
CONFIG_USB_F_MASS_STORAGE=m
CONFIG_USB_F_HID=m
CONFIG_USB_CONFIGFS=m
CONFIG_USB_CONFIGFS_SERIAL=y
CONFIG_USB_CONFIGFS_ACM=y
CONFIG_USB_CONFIGFS_NCM=y
CONFIG_USB_CONFIGFS_ECM=y
CONFIG_USB_CONFIGFS_ECM_SUBSET=y
CONFIG_USB_CONFIGFS_EEM=y
CONFIG_USB_ETH=m
CONFIG_USB_ETH_RNDIS=y
CONFIG_USB_ETH_EEM=y
CONFIG_USB_G_NCM=m
CONFIG_USB_CDC_COMPOSITE=m
```

## meta-bf/meta-mavericks/conf/layer.conf
```bitbake
# We have a conf and classes directory, add to BBPATH
BBPATH .= ":${LAYERDIR}"

# We have recipes-* directories, add to BBFILES
BBFILES += "${LAYERDIR}/recipes-*/*/*.bb \
	${LAYERDIR}/recipes-*/*/*.bbappend"

BBFILE_COLLECTIONS += "mavericks"
BBFILE_PATTERN_mavericks = "^${LAYERDIR}/"
BBFILE_PRIORITY_mavericks = "25"
```

## meta-bf/meta-mavericks/conf/local.conf.sample
```bitbake
#
# Local configuration file for building the OpenBMC image.
#

# Machine Selection
MACHINE ??= "mavericks"

# OpenBMC distro settings
DISTRO ?= "openbmc-fb"
```

## meta-cisco/conf/layer.conf
```bitbake
# We have a conf and classes directory, add to BBPATH
BBPATH .= ":${LAYERDIR}"

# We have recipes-* directories, add to BBFILES
BBFILES += "${LAYERDIR}/recipes-*/*/*.bb \
        ${LAYERDIR}/recipes-*/*/*.bbappend"

BBFILE_COLLECTIONS += "cisco"
BBFILE_PATTERN_cisco = "^${LAYERDIR}/"

LAYERSERIES_COMPAT_cisco = "dunfell"

LICENSE_PATH += "${LAYERDIR}/custom-licenses"
COMPANY_COMMON_LICENSES := '${@os.path.normpath("${LAYERDIR}/custom-licenses")}'
```

## meta-delta/conf/layer.conf
```bitbake
# We have a conf and classes directory, add to BBPATH
BBPATH .= ":${LAYERDIR}"

# We have recipes-* directories, add to BBFILES
BBFILES += "${LAYERDIR}/recipes-*/*/*.bb \
	${LAYERDIR}/recipes-*/*/*.bbappend"

BBFILE_COLLECTIONS += "delta"
BBFILE_PATTERN_delta = "^${LAYERDIR_RE}/recipes"
BBFILE_PRIORITY_delta = "15"


LAYERSERIES_COMPAT_delta = "kirkstone dunfell"

BB_DANGLINGAPPENDS_WARNONLY = "1"
```

## meta-delta/meta-agc032a/conf/bblayers.conf
```bitbake
# LAYER_CONF_VERSION is increased each time build/conf/bblayers.conf
# changes incompatibly
LCONF_VERSION = "6"

BBPATH = "${TOPDIR}"
BBFILES ?= ""

BBLAYERS ?= " \
  /home/charlene.yang/openbmc/yocto/zeus/poky/meta \
  /home/charlene.yang/openbmc/yocto/zeus/poky/meta-poky \
  /home/charlene.yang/openbmc/yocto/zeus/poky/meta-openembedded/meta-oe \
  /home/charlene.yang/openbmc/yocto/zeus/poky/meta-openembedded/meta-networking \
  /home/charlene.yang/openbmc/yocto/zeus/poky/meta-openembedded/meta-python \
  /home/charlene.yang/openbmc/yocto/zeus/poky/meta-openembedded/meta-perl \
  /home/charlene.yang/openbmc/yocto/zeus/poky/../.. \
  /home/charlene.yang/openbmc/yocto/zeus/poky/meta-security \
  /home/charlene.yang/openbmc/yocto/zeus/poky/meta-security/meta-tpm \
  /home/charlene.yang/openbmc/yocto/zeus/poky/../../meta-aspeed \
  /home/charlene.yang/openbmc/yocto/zeus/poky/../../meta-facebook \
  /home/charlene.yang/openbmc/yocto/zeus/poky/../../meta-facebook/meta-python3 \
  /home/charlene.yang/openbmc/yocto/zeus/poky/../../meta-facebook/meta-backports \
  /home/charlene.yang/openbmc/yocto/zeus/poky/../../meta-delta \
  /home/charlene.yang/openbmc/yocto/zeus/poky/../../meta-delta/meta-agc032a \
  "
BBLAYERS_NON_REMOVABLE ?= " \
  /home/charlene.yang/openbmc/yocto/zeus/poky/meta \
  /home/charlene.yang/openbmc/yocto/zeus/poky/meta-yocto \
  "
```
