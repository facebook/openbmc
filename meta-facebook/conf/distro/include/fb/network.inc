## meta-facebook/conf/distro/include/fb/network.inc
```bitbake
# Distro settings unique to the Facebook network.

# Set up internal source mirrors and block the internet.
INHERIT += "fb-source-mirror fb-only-network"
# If you need to download new packages from the internet you can
# temporarily add 'INHERIT:remove = "fb-only-network"' to your
# `conf/local.conf`.

def force_shallow_tarballs(d):
    distro = d.getVar('DISTRO_CODENAME', True)
    if distro in [ 'rocko', 'dunfell' ]:
        return "0"
    return "1"

# Save local tarballs for all packages we download.
# This can be used to update our mirror directory above.
BB_GENERATE_MIRROR_TARBALLS = "1"
BB_GENERATE_SHALLOW_TARBALLS ?= "${@force_shallow_tarballs(d)}"
BB_GIT_SHALLOW ?= "${@force_shallow_tarballs(d)}"

# Do not check reachability as it does not work in our environment
CONNECTIVITY_CHECK_URIS = ""
```

## meta-facebook/conf/distro/include/fb/parallel.inc
```bitbake
# How many tasks bitbake should run in parallel:
BB_NUMBER_THREADS ?= "${@oe.utils.cpu_count()}"
# How many processes make should run in parallel:
PARALLEL_MAKE ?= "-j ${@oe.utils.cpu_count()}"
```

## meta-facebook/conf/distro/include/fb/sstate.inc
```bitbake
# Set common sstate directory.
def fb_sstate_location(d):
    is_openbmc_root = lambda cur: \
        os.path.isdir(os.path.join(cur, '.git')) and \
        os.path.isfile(os.path.join(cur, 'openbmc-init-build-env'))

    # Find the openbmc root directory.
    openbmc_root = d.getVar('COREBASE', True)
    while openbmc_root and openbmc_root != '/' and \
            not is_openbmc_root(openbmc_root):
        openbmc_root = os.path.dirname(openbmc_root)

    return os.path.join(openbmc_root, '.sstate')

SSTATE_DIR ?= "${@fb_sstate_location(d)}"

# Use pre-packaged sstate mirrors.
SSTATE_MIRRORS ?= "\
  file://.* \
  file:///data/users/openbmc/openbmc.sstatecache/LAST/.sstate/PATH \
  file://.* \
  file:///data/sandcastle/temp/openbmc_sstate/.sstate/PATH \
  file://.* \
  file:///data/sandcastle/temp/skycastle/openbmc_sstate/.sstate/PATH "
```

## meta-facebook/conf/distro/include/fb/versioning.inc
```bitbake
# Set the OpenBMC Version information for all recipes.
INHERIT += "openbmc_version"

DISTRO_NAME = "Facebook OpenBMC"
TARGET_VENDOR = "-fb"
SDK_VENDOR = "-fbsdk"

MAINTAINER = "Facebook OpenBMC Developers <obmc-dev@fb.com>"
```

## meta-facebook/conf/distro/openbmc-fb-2.conf
```bitbake
# Yocto versions Honister and above need a bump to the CONF_VERSION.
CONF_VERSION = "2"

require conf/distro/openbmc-fb.conf
```

## meta-facebook/conf/distro/openbmc-fb-lf.conf
```bitbake
# Use the phosphor distro as the base.
DISTRO_CODENAME = "master"
require conf/distro/openbmc-phosphor.conf
require conf/distro/include/fb-base.inc

# Load hook point for potential overrides from upstream machine configs.
include conf/machine/${MACHINE}-upstream-overrides.conf

DISTROOVERRIDES .= ":openbmc-fb-lf"

OS_RELEASE_ROOTPATH ?= "${COREBASE}/../../"

USER_CLASSES ?= "buildstats"
```

## meta-facebook/conf/distro/openbmc-fb-master.conf
```bitbake
DISTRO_CODENAME="master"
# Yocto versions Honister and above need a bump to the CONF_VERSION.
CONF_VERSION = "2"
require conf/distro/include/fb-openbmc.inc

# Starting in Yocto-Nanbield, the CONVERSION_CMDs are no longer expected to
# use the IMAGE_NAME_SUFFIX, but we need our `fb-openbmc-image` to support
# both older and new Yocto.  We can set IMAGE_NAME_SUFFIX to an empty string
# on master and satisfy both.
IMAGE_NAME_SUFFIX=""
```

## meta-facebook/conf/distro/openbmc-fb.conf
```bitbake
# Facebook OpenBMC distro

# Use the base poky distro, but override various parameters.
require conf/distro/poky.conf
require conf/distro/include/fb-base.inc
DISTROOVERRIDES .= ":openbmc-fb"

# Extra image features.
EXTRA_IMAGE_FEATURES += "ssh-server-openssh tools-debug"
CORE_IMAGE_EXTRA_INSTALL += "ldd"

# List of supported distros we are using
SANITY_TESTED_DISTROS += " \
            CentOSLinux-7.[345].* \n \
            "

#
# Additional image features
#
# The following is a list of additional classes to use when building images which
# enable extra features. Some available options which can be included in this variable
# are:
#   - 'buildstats' collect build statistics
#   - 'image-swab' to perform host system intrusion detection
USER_CLASSES ?= "buildstats"

# Update root password to '0penBmc' and change the root shell back to bash.
# This default root password is used at the ODM and system integrator. It will be
# changed during provisioning at the datacenter.
INHERIT += "extrausers"

EXTRA_USERS_PARAMS += " \
  usermod -s /bin/bash root; \
  usermod -p '\$1\$UGMqyqdG\$FZiylVFmRRfl9Z0Ue8G7e/' root; \
  "

OPENBMC_FB_DEFAULT_FEATURE = "ext2 ipv6 largefile usbgadget usbhost nfs zeroconf package-management ipv4 ptest"
OPENBMC_BOARD_FEATURE ?= ""
DISTRO_FEATURES = "${DISTRO_FEATURES_LIBC} ${OPENBMC_FB_DEFAULT_FEATURE} ${OPENBMC_BOARD_FEATURE}"
DISTRO_FEATURES_BACKFILL_CONSIDERED = "\
    pulseaudio bluez5 gobject-introspection-data ldconfig"

# CONF_VERSION is increased each time build/conf/ changes incompatibly and is used to
# track the version of this file when it was generated. This can safely be ignored if
# this doesn't mean anything to you.
CONF_VERSION ?= "1"

HOSTTOOLS += "realpath"

PREFERRED_VERSION_asd ?= "0.1"
```

## meta-facebook/conf/layer.conf
```bitbake
# We have a conf and classes directory, add to BBPATH
BBPATH .= ":${LAYERDIR}"

# We have recipes-* directories, add to BBFILES
BBFILES += "${LAYERDIR}/recipes-*/*/*.bb \
	${LAYERDIR}/recipes-*/*/*.bbappend"

BBFILE_COLLECTIONS += "facebook"
BBFILE_PATTERN_facebook = "^${LAYERDIR_RE}/recipes"
BBFILE_PRIORITY_facebook = "15"


LAYERSERIES_COMPAT_facebook = "zeus warrior rocko"

BB_DANGLINGAPPENDS_WARNONLY = "1"
```

## meta-facebook/conf/machine/include/fb-fboss.inc
```bitbake
# Copyright (c) Meta Platforms, Inc. and affiliates.

#
# All the FBOSS platfroms should install libwatchdog-0.2 because they
# were moved out of kernel 4.1 (libwatchdog-0.1 is for kernel 4.1).
#
PREFERRED_VERSION_libwatchdog = "0.2"

#
# All the FBOSS BMC-Classis platforms should install wedge-eeprom-0.1.
# All the FBOSS BMC-Lite platforms should pick up wedge-eeprom-0.2 to
# support Meta EEPROM v4+, except fbdarwin (needs wedge-eeprom-0.1).
#
PREFERRED_VERSION_wedge-eeprom ?= "0.1"
PREFERRED_VERSION_libwedge-eeprom ?= "0.1"
```

## meta-facebook/conf/machine/include/runqemu.inc
```bitbake
IMAGE_CLASSES += "qemuboot"

def qemu_helper_for_distro(d):
    distro = d.getVar('DISTRO_CODENAME')

    if distro in [ 'master' ]:
        return "qemu-helper-native:do_addto_recipe_sysroot"

    return ""

EXTRA_IMAGEDEPENDS:append = " ${@qemu_helper_for_distro(d)}"

QB_SYSTEM_NAME = "qemu-system-arm"
QB_MACHINE = "-machine ${MACHINE}-bmc"
QB_MEM = "2G"
QB_RNG = ""
QB_ROOTFS = "none"
QB_OPT_APPEND = \
    "-drive file=@DEPLOY_DIR_IMAGE@/flash-${MACHINE},format=raw,if=mtd,snapshot=on \
     -drive file=@DEPLOY_DIR_IMAGE@/flash-${MACHINE},format=raw,if=mtd,snapshot=on"
QB_NETWORK_DEVICE = " -net nic,model=ftgmac100,netdev=net0 "
QB_DEFAULT_KERNEL = "none"
QB_DEFAULT_FSTYPE = "none"
QB_SERIAL_OPT = " -serial mon:stdio -serial null "
QB_GRAPHICS = ""
QB_SLIRP_OPT = " -netdev user,id=net0,mfr-id=0x8119,oob-eth-addr=aa:bb:cc:dd:ee:ff,hostfwd=::2222-:22 "
```

## meta-facebook/meta-backports/conf/layer.conf
```bitbake
# We have a conf and classes directory, add to BBPATH
BBPATH .= ":${LAYERDIR}"
# Prepend distro path to BBPATH so that we can override classes in backports.
BBPATH =. "${LAYERDIR}/${DISTRO_CODENAME}:"

# We have recipes-* directories, add to BBFILES
BBFILES += "${LAYERDIR}/${DISTRO_CODENAME}/recipes-*/*/*.bb \
        ${LAYERDIR}/${DISTRO_CODENAME}/recipes-*/*/*.bbappend \
        ${LAYERDIR}/${DISTRO_CODENAME}/facebook/recipes-*/*/*.bb \
        ${LAYERDIR}/${DISTRO_CODENAME}/facebook/recipes-*/*/*.bbappend"

BBFILE_COLLECTIONS += "backports"
BBFILE_PATTERN_backports = "^${LAYERDIR}/${DISTRO_CODENAME}/(recipes|facebook)"
# Top priority, append over all else
BBFILE_PRIORITY_backports = "99"

LAYERSERIES_COMPAT_backports = "mickledore kirkstone dunfell rocko"
```

## meta-facebook/meta-churchillmono/conf/bblayers.conf.sample
```bitbake
# LAYER_CONF_VERSION is increased each time build/conf/bblayers.conf
# changes incompatibly
LCONF_VERSION = "6"

BBPATH = "${TOPDIR}"
BBFILES ?= ""

BBLAYERS ?= " \
  ##OEROOT##/meta \
  ##OEROOT##/meta-poky \
  ##OEROOT##/meta-openembedded/meta-oe \
  ##OEROOT##/meta-openembedded/meta-networking \
  ##OEROOT##/meta-openembedded/meta-python \
  ##OEROOT##/meta-openembedded/meta-perl \
  ##OEROOT##/../.. \
  ##OEROOT##/meta-security \
  ##OEROOT##/meta-security/meta-tpm \
  ##OEROOT##/../../meta-aspeed \
  ##OEROOT##/../../meta-facebook \
  ##OEROOT##/../../meta-facebook/meta-churchillmono \
  ##OEROOT##/../../meta-facebook/meta-python3 \
  ##OEROOT##/../../meta-facebook/meta-backports \
  "

# To build with the proprietary tree, comment these lines
# for OSS build
BBLAYERS:append = " \
  ##OEROOT##/../../proprietary/cisco/meta-cisco \
  ##OEROOT##/../../proprietary/cisco/meta-churchillmono \
"

BBLAYERS_NON_REMOVABLE ?= " \
  ##OEROOT##/meta \
  ##OEROOT##/meta-poky \
  "
```

## meta-facebook/meta-churchillmono/conf/layer.conf
```bitbake
# We have a conf and classes directory, add to BBPATH
BBPATH .= ":${LAYERDIR}"

FB_PROPRIETARY_RECIPES:fb-proprietary-recipes = " \
    ${LAYERDIR}/../../proprietary/cisco/meta-cisco/recipes-*/*/*.bb \
    ${LAYERDIR}/../../proprietary/cisco/meta-cisco/recipes-*/*/*.bbappend \
    ${LAYERDIR}/../../proprietary/cisco/meta-churchillmono/recipes-*/*/*.bb \
    ${LAYERDIR}/../../proprietary/cisco/meta-churchillmono/recipes-*/*/*.bbappend \
    "

# We have recipes-* directories, add to BBFILES
BBFILES += "\
    ${LAYERDIR}/recipes-*/*/*.bb \
    ${LAYERDIR}/recipes-*/*/*.bbappend \
    ${FB_PROPRIETARY_RECIPES} \
    "

BBFILE_COLLECTIONS += "churchillmono"
BBFILE_PATTERN_churchillmono = "^${LAYERDIR}/"
BBFILE_PRIORITY_churchillmono = "20"

LAYERSERIES_COMPAT_churchillmono = "mickledore langdale kirkstone dunfell"

DISTRO_FEATURES:append = " systemd"
VIRTUAL-RUNTIME_init_manager = "systemd"

LICENSE_PATH:fb-proprietary-recipes += "${LAYERDIR}/../../proprietary/cisco/meta-cisco/custom-licenses"
COMPANY_COMMON_LICENSES:fb-proprietary-recipes := '${@os.path.normpath("${LAYERDIR}/../../proprietary/cisco/meta-cisco/custom-licenses")}'
```

## meta-facebook/meta-churchillmono/conf/local.conf.sample
```bitbake
#
# Local configuration file for building the OpenBMC image.
#

# Machine Selection
MACHINE ??= "churchillmono"

# OpenBMC distro settings - Keeping as openbmc-fb to avoid incompatibilities
DISTRO ?= "openbmc-fb"
```

## meta-facebook/meta-churchillmono/conf/machine/churchillmono.conf
```bitbake
#@TYPE: Machine
#@NAME: Churchillmono
#@DESCRIPTION: Machine configuration for Cisco ChurchillMono

require conf/machine/include/ast2620.inc
require conf/machine/include/mtd-ubifs.inc

KERNEL_IMAGETYPE = "zImage"

# Uniquely identifies U-boot and Kernel
UBOOT_MACHINE:churchillmono = "cisco-churchillmono_defconfig"
KERNEL_DEVICETREE = "aspeed-bmc-cisco-churchillmono.dtb"

# U-boot and Linux Kernel Versions
PREFERRED_VERSION_linux-aspeed = "5.10.%"
PREFERRED_VERSION_u-boot = "v2019.04"
PREFERRED_VERSION_u-boot-tools = "v2019.04"
PREFERRED_VERSION_u-boot-tools-native = "v2019.04"
PREFERRED_VERSION_nativesdk-u-boot-tools = "v2019.04"
PREFERRED_VERSION_u-boot-fw-utils = "v2019.04"
PREFERRED_VERSION_u-boot-fw-utils-cross = "v2019.04"

PREFERRED_VERSION_libwatchdog = "0.2"

MACHINE_FEATURES += "tpm2"
MACHINE_FEATURES += "emmc emmc-ext4"

MACHINE_ESSENTIAL_EXTRA_RDEPENDS += "           \
    kernel-module-i2c-dev-sysfs                 \
    "

EXTRA_IMAGE_FEATURES:append = " image-meta"
FW_ENV_CONFIG_FILE = "fw_env.config.64k"
```

## meta-facebook/meta-clearcreek/conf/layer.conf
```bitbake
# We have a conf and classes directory, add to BBPATH
BBPATH .= ":${LAYERDIR}"

# We have recipes-* directories, add to BBFILES
BBFILES += "${LAYERDIR}/recipes-*/*/*.bb \
	${LAYERDIR}/recipes-*/*/*.bbappend"

BBFILE_COLLECTIONS += "clearcreek"
BBFILE_PATTERN_clearcreek = "^${LAYERDIR}/"
BBFILE_PRIORITY_clearcreek = "20"

LAYERSERIES_COMPAT_clearcreek = "mickledore kirkstone dunfell"
```

## meta-facebook/meta-clearcreek/conf/machine/clearcreek.conf
```bitbake
#@TYPE: Machine
#@NAME: Clear Creek
#@DESCRIPTION: Machine configuration for Facebook IO Expander

require conf/machine/include/ast2520.inc

UBOOT_MACHINE:clearcreek = "fbcc_defconfig"
UBOOT_CONFIG_BASE = "fbobmc-ast-g5-tpm2_defconfig"
KERNEL_IMAGETYPE = "zImage"
KERNEL_DEVICETREE = "aspeed-bmc-facebook-clearcreek.dtb"

# configuration for preferred version of packages
PREFERRED_VERSION_u-boot = "v2019.04"
PREFERRED_VERSION_u-boot-fw-utils = "v2019.04"
PREFERRED_VERSION_u-boot-fw-utils-cross = "v2019.04"
PREFERRED_VERSION_u-boot-tools = "v2019.04"
PREFERRED_VERSION_u-boot-tools-native = "v2019.04"
PREFERRED_VERSION_nativesdk-u-boot-tools = "v2019.04"

PREFERRED_VERSION_linux-aspeed = "5.6.19"
PREFERRED_VERSION_libwatchdog = "0.2"

require conf/machine/include/fb-compute.inc
require conf/machine/include/tpm2.inc

EXTRA_IMAGE_FEATURES:append = " verified-boot image-meta "
FW_ENV_CONFIG_FILE = "fw_env.config.64k"
```
