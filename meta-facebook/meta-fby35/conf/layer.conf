## meta-facebook/meta-fby35/conf/layer.conf
```bitbake
# We have a conf and classes directory, add to BBPATH
BBPATH .= ":${LAYERDIR}"

# We have recipes-* directories, add to BBFILES
BBFILES += "${LAYERDIR}/recipes-*/*/*.bb \
	${LAYERDIR}/recipes-*/*/*.bbappend"

BBFILE_COLLECTIONS += "fby35"
BBFILE_PATTERN_fby35 = "^${LAYERDIR}/"
BBFILE_PRIORITY_fby35 = "20"

LAYERSERIES_COMPAT_fby35 = "kirkstone honister dunfell"
```

## meta-facebook/meta-fby35/conf/local.conf.sample
```bitbake
#
# Local configuration file for building the OpenBMC image.
#

# Machine Selection
MACHINE ??= "fby35"

# OpenBMC distro settings
DISTRO ?= "openbmc-fb-2"
```

## meta-facebook/meta-fby35/conf/machine/fby35.conf
```bitbake
#@TYPE: Machine
#@NAME: FBY35
#@DESCRIPTION: Machine configuration for Facebook FBY35

require conf/machine/include/ast2620.inc

KERNEL_IMAGETYPE = "zImage"
UBOOT_MACHINE:fby35 = "facebook-fby35_defconfig"
UBOOT_CONFIG_BASE = "fbobmc-ast-g6_defconfig"

KERNEL_DEVICETREE = "aspeed-bmc-facebook-fby35.dtb"
PREFERRED_VERSION_linux-aspeed = "5.15.%"

PREFERRED_VERSION_u-boot = "v2019.04%"
PREFERRED_VERSION_u-boot-tools = "v2019.04%"
PREFERRED_VERSION_u-boot-tools-native = "v2019.04%"
PREFERRED_VERSION_nativesdk-u-boot-tools = "v2019.04%"
PREFERRED_VERSION_u-boot-fw-utils = "v2019.04%"
PREFERRED_VERSION_u-boot-fw-utils-cross = "v2019.04%"

PREFERRED_VERSION_libwatchdog = "0.2"
PREFERRED_VERSION_libbic = "0.1"
PREFERRED_VERSION_asd = "1.4.7"
PREFERRED_VERSION_libasd-jtagintf = "1.4.7"

require conf/machine/include/fb-bic.inc
require conf/machine/include/fb-compute.inc
require conf/machine/include/mtd-ubifs.inc
require conf/machine/include/ncsi.inc
require conf/machine/include/tpm2.inc
require conf/machine/include/runqemu.inc

MACHINE_ESSENTIAL_EXTRA_RDEPENDS += "           \
    "

EXTRA_IMAGE_FEATURES:append = " verified-boot image-meta"
FW_ENV_CONFIG_FILE = "fw_env.config.64k"
FBVBOOT_GOLDEN_IMAGE_SIZE_MB = "64"
```

## meta-facebook/meta-fby35/meta-greatlakes/conf/layer.conf
```bitbake
# We have a conf and classes directory, add to BBPATH
BBPATH .= ":${LAYERDIR}"

# We have recipes-* directories, add to BBFILES
BBFILES += "${LAYERDIR}/recipes-*/*/*.bb \
	${LAYERDIR}/recipes-*/*/*.bbappend"

BBFILE_COLLECTIONS += "greatlakes"
BBFILE_PATTERN_greatlakes = "^${LAYERDIR}/"
BBFILE_PRIORITY_greatlakes = "25"

LAYERSERIES_COMPAT_greatlakes = "mickledore langdale kirkstone dunfell"
```

## meta-facebook/meta-fby35/meta-halfdome/conf/layer.conf
```bitbake
# We have a conf and classes directory, add to BBPATH
BBPATH .= ":${LAYERDIR}"

# We have recipes-* directories, add to BBFILES
BBFILES += "${LAYERDIR}/recipes-*/*/*.bb \
	${LAYERDIR}/recipes-*/*/*.bbappend"

BBFILE_COLLECTIONS += "halfdome"
BBFILE_PATTERN_halfdome = "^${LAYERDIR}/"
BBFILE_PRIORITY_halfdome = "25"

LAYERSERIES_COMPAT_fby35 = "kirkstone dunfell"
```

## meta-facebook/meta-fby35/meta-halfdome/conf/local.conf.sample
```bitbake
#
# Local configuration file for building the OpenBMC image.
#

# Machine Selection
MACHINE ??= "halfdome"

# OpenBMC distro settings
DISTRO ?= "openbmc-fb-2"
```

## meta-facebook/meta-fby35/meta-javaisland/conf/layer.conf
```bitbake
# We have a conf and classes directory, add to BBPATH
BBPATH .= ":${LAYERDIR}"

# We have recipes-* directories, add to BBFILES
BBFILES += "${LAYERDIR}/recipes-*/*/*.bb \
	${LAYERDIR}/recipes-*/*/*.bbappend"

BBFILE_COLLECTIONS += "javaisland"
BBFILE_PATTERN_javaisland = "^${LAYERDIR}/"
BBFILE_PRIORITY_javaisland = "25"

LAYERSERIES_COMPAT_javaisland = "scarthgap nanbield kirkstone dunfell"
```

## meta-facebook/meta-fuji/conf/layer.conf
```bitbake
# We have a conf and classes directory, add to BBPATH
BBPATH .= ":${LAYERDIR}"

# We have recipes-* directories, add to BBFILES
BBFILES += "${LAYERDIR}/recipes-*/*/*.bb \
	${LAYERDIR}/recipes-*/*/*.bbappend"

BBFILE_COLLECTIONS += "fuji"
BBFILE_PATTERN_fuji = "^${LAYERDIR}/"
BBFILE_PRIORITY_fuji = "20"

LAYERSERIES_COMPAT_fuji = "mickledore langdale kirkstone dunfell"

#Will enable the following once we have all the needed packages ready
DISTRO_FEATURES_append = " systemd"
VIRTUAL-RUNTIME_init_manager = "systemd"
DISTRO_FEATURES_BACKFILL_CONSIDERED += "sysvinit"
VIRTUAL-RUNTIME_initscripts = "systemd-compat-units"
```

## meta-facebook/meta-fuji/conf/machine/fuji.conf
```bitbake
#@TYPE: Machine
#@NAME: Fuji
#@DESCRIPTION: Machine configuration for Facebook Fuji

require conf/machine/include/ast2620.inc

KERNEL_IMAGETYPE = "zImage"
UBOOT_MACHINE_fuji = "facebook-fuji_defconfig"

KERNEL_DEVICETREE = "aspeed-bmc-facebook-fuji.dtb"
PREFERRED_VERSION_linux-aspeed = "5.4.11"

PREFERRED_VERSION_u-boot = "v2019.04"
PREFERRED_VERSION_u-boot-mkimage = "v2019.04"
PREFERRED_VERSION_u-boot-mkimage-native = "v2019.04"
PREFERRED_VERSION_nativesdk-u-boot-mkimage = "v2019.04"
PREFERRED_VERSION_u-boot-fw-utils = "v2019.04"
PREFERRED_VERSION_u-boot-fw-utils-cross = "v2019.04"

PREFERRED_VERSION_libwatchdog = "0.2"
MACHINE_ESSENTIAL_EXTRA_RDEPENDS += "           \
    kernel-module-cpld                          \
    kernel-module-i2c-dev-sysfs                 \
    kernel-module-i2c-dev-domfpga               \
    "
```

## meta-facebook/meta-galaxy100/conf/bblayers.conf.sample
```bitbake
# LAYER_CONF_VERSION is increased each time build/conf/bblayers.conf
# changes incompatibly
LCONF_VERSION = "6"

BBPATH = "${TOPDIR}"
BBFILES ?= ""

BBLAYERS ?= " \
  ##OEROOT##/meta \
  ##OEROOT##/meta-poky \
  ##OEROOT##/meta-yocto-bsp \
  ##OEROOT##/meta-openembedded/meta-oe \
  ##OEROOT##/meta-openembedded/meta-networking \
  ##OEROOT##/meta-openembedded/meta-python \
  ##OEROOT##/meta-openbmc \
  ##OEROOT##/meta-openbmc/meta-aspeed \
  ##OEROOT##/meta-openbmc/meta-facebook \
  ##OEROOT##/meta-openbmc/meta-facebook/meta-wedge \
  ##OEROOT##/meta-openbmc/meta-facebook/meta-wedge100 \
  ##OEROOT##/meta-openbmc/meta-facebook/meta-galaxy100 \
  "
BBLAYERS_NON_REMOVABLE ?= " \
  ##OEROOT##/meta \
  ##OEROOT##/meta-poky \
  "
```

## meta-facebook/meta-galaxy100/conf/layer.conf
```bitbake
# We have a conf and classes directory, add to BBPATH
BBPATH .= ":${LAYERDIR}"

# We have recipes-* directories, add to BBFILES
BBFILES += "${LAYERDIR}/recipes-*/*/*.bb \
	${LAYERDIR}/recipes-*/*/*.bbappend"

BBFILE_COLLECTIONS += "galaxy100"
BBFILE_PATTERN_galaxy100 = "^${LAYERDIR}/"
BBFILE_PRIORITY_galaxy100 = "30"

LAYERSERIES_COMPAT_galaxy100 = "mickledore langdale kirkstone dunfell rocko"

# We would inherit systemd from wedge otherwise (temporarily disabled):
DISTRO_FEATURES:remove = "systemd"
VIRTUAL-RUNTIME_init_manager = "sysvinit"
DISTRO_FEATURES_BACKFILL_CONSIDERED:remove += "sysvinit"
VIRTUAL-RUNTIME_initscripts = "initscripts"
```

## meta-facebook/meta-galaxy100/conf/machine/galaxy100.conf
```bitbake
#@TYPE: Machine
#@NAME: galaxy100
#@DESCRIPTION: Machine configuration for Facebook Backpack LC/FC

require conf/machine/include/ast1250.inc
require conf/machine/include/fb-fboss.inc

KERNEL_IMAGETYPE = "zImage"
UBOOT_MACHINE:galaxy100 = "facebook-backpack_defconfig"
UBOOT_CONFIG_BASE = "fbobmc-ast-g4_defconfig"

#
# U-boot version.
#
PREFERRED_VERSION_u-boot = "v2019.04%"
PREFERRED_VERSION_u-boot-fw-utils = "v2019.04%"
PREFERRED_VERSION_u-boot-fw-utils-cross = "v2019.04%"
PREFERRED_VERSION_u-boot-tools = "v2019.04%"
PREFERRED_VERSION_u-boot-tools-native = "v2019.04%"
PREFERRED_VERSION_nativesdk-u-boot-tools = "v2019.04%"
PREFERRED_PROVIDER_u-boot-mkimage-native = "u-boot-tools-native"

#
# Kernel version.
#
KERNEL_DEVICETREE = "aspeed-bmc-facebook-galaxy100.dtb"
PREFERRED_VERSION_linux-aspeed = "5.15.%"

#
# Preferred version of user space packages.
#
PREFERRED_VERSION_libipmi = "0.2"
PREFERRED_VERSION_ipmid = "0.1"
PREFERRED_VERSION_rest-api = "0.1"
PREFERRED_VERSION_at93cx6-util = "0.1"
PREFERRED_VERSION_bcm5396-util = "0.1"
PREFERRED_VERSION_kcsd = "0.1"
PREFERRED_VERSION_openbmc-gpio = "0.2"

MACHINE_ESSENTIAL_EXTRA_RDEPENDS += "           \
    kernel-module-cpld                          \
    kernel-module-i2c                           \
    "
```

## meta-facebook/meta-grandcanyon/conf/layer.conf
```bitbake
# We have a conf and classes directory, add to BBPATH
BBPATH .= ":${LAYERDIR}"

# We have recipes-* directories, add to BBFILES
BBFILES += "${LAYERDIR}/recipes-*/*/*.bb \
	${LAYERDIR}/recipes-*/*/*.bbappend"

BBFILE_COLLECTIONS += "grandcanyon"
BBFILE_PATTERN_grandcanyon = "^${LAYERDIR}/"
BBFILE_PRIORITY_grandcanyon = "20"

LAYERSERIES_COMPAT_grandcanyon = "kirkstone dunfell"
```

## meta-facebook/meta-grandcanyon/conf/local.conf.sample
```bitbake
#
# Local configuration file for building the OpenBMC image.
#

CONF_VERSION = "2"

# Machine Selection
MACHINE ??= "grandcanyon"

# OpenBMC distro settings
DISTRO ?= "openbmc-fb"
```

## meta-facebook/meta-grandcanyon/conf/machine/grandcanyon.conf
```bitbake
#@TYPE: Machine
#@NAME: GrandCanyon
#@DESCRIPTION: Machine configuration for Facebook GrandCanyon

require conf/machine/include/ast2620.inc

KERNEL_IMAGETYPE = "zImage"
UBOOT_MACHINE:grandcanyon = "facebook-grandcanyon_defconfig"
UBOOT_CONFIG_BASE = "fbobmc-ast-g6_defconfig"

KERNEL_DEVICETREE = "aspeed-bmc-facebook-grandcanyon.dtb"
PREFERRED_VERSION_linux-aspeed = "5.10.%"

PREFERRED_VERSION_u-boot = "v2019.04"
PREFERRED_VERSION_u-boot-tools = "v2019.04"
PREFERRED_VERSION_u-boot-tools-native = "v2019.04"
PREFERRED_VERSION_nativesdk-u-boot-tools = "v2019.04"
PREFERRED_VERSION_u-boot-fw-utils = "v2019.04"
PREFERRED_VERSION_u-boot-fw-utils-cross = "v2019.04"

PREFERRED_VERSION_libwatchdog = "0.2"
PREFERRED_VERSION_libbic = "0.1"
PREFERRED_VERSION_bic-util = "0.1"

PREFERRED_VERSION_bios-util = "0.2"
PREFERRED_VERSION_asd = "1.4.3"

require conf/machine/include/ncsi.inc
require conf/machine/include/tpm2.inc

MACHINE_FEATURES += "compute-rest"
MACHINE_FEATURES += "mtd-ubifs"

MACHINE_ESSENTIAL_EXTRA_RDEPENDS += "           \
    "

EXTRA_IMAGE_FEATURES:append = "  verified-boot image-meta"
FW_ENV_CONFIG_FILE = "fw_env.config.64k"
```

## meta-facebook/meta-grandteton/conf/layer.conf
```bitbake
# We have a conf and classes directory, add to BBPATH
BBPATH .= ":${LAYERDIR}"

# We have recipes-* directories, add to BBFILES
BBFILES += "${LAYERDIR}/recipes-*/*/*.bb \
	${LAYERDIR}/recipes-*/*/*.bbappend"

BBFILE_COLLECTIONS += "grandteton"
BBFILE_PATTERN_grandteton = "^${LAYERDIR}/"
BBFILE_PRIORITY_grandteton = "20"

LAYERSERIES_COMPAT_grandteton = "mickledore langdale kirkstone dunfell"

# For systemd uncomment the following
#DISTRO_FEATURES:append = " systemd"
#VIRTUAL-RUNTIME_init_manager = "systemd"
#DISTRO_FEATURES_BACKFILL_CONSIDERED += "sysvinit"
#VIRTUAL-RUNTIME_initscripts = "systemd-compat-units"
```

## meta-facebook/meta-grandteton/meta-gtartemis/conf/layer.conf
```bitbake
# We have a conf and classes directory, add to BBPATH
BBPATH .= ":${LAYERDIR}"

# We have recipes-* directories, add to BBFILES
BBFILES += "${LAYERDIR}/recipes-*/*/*.bb \
  ${LAYERDIR}/recipes-*/*/*.bbappend"

BBFILE_COLLECTIONS += "gtartemis"
BBFILE_PATTERN_gtartemis = "^${LAYERDIR}/"
BBFILE_PRIORITY_gtartemis = "30"

LAYERSERIES_COMPAT_gtartemis = "mickledore langdale kirkstone"
```

## meta-facebook/meta-grandteton/meta-gtartemis/conf/machine/gtartemis.conf
```bitbake
#@TYPE: Machine
#@NAME: gtartemis (Grand Teton Artemis)
#@DESCRIPTION: Machine configuration for Facebook Grand Teton Artemis platform

require conf/machine/include/ast2620.inc

KERNEL_IMAGETYPE = "zImage"
UBOOT_MACHINE:gtartemis = "facebook-gtartemis_defconfig"
UBOOT_CONFIG_BASE = "fbobmc-ast-g6_defconfig"

KERNEL_DEVICETREE = "aspeed-bmc-facebook-gtartemis.dtb"
PREFERRED_VERSION_linux-aspeed = "5.10.%"

PREFERRED_VERSION_u-boot = "v2019.04%"
PREFERRED_VERSION_u-boot-tools = "v2019.04%"
PREFERRED_VERSION_u-boot-tools-native = "v2019.04%"
PREFERRED_VERSION_nativesdk-u-boot-tools = "v2019.04%"
PREFERRED_VERSION_u-boot-fw-utils = "v2019.04%"
PREFERRED_VERSION_u-boot-fw-utils-cross = "v2019.04%"
PREFERRED_VERSION_libretimer = "2.14"

PREFERRED_VERSION_libwatchdog = "0.2"

require conf/machine/include/fb-compute.inc
require conf/machine/include/mtd-ubifs.inc
require conf/machine/include/tpm2.inc

MACHINE_ESSENTIAL_EXTRA_RDEPENDS += "           \
    "

EXTRA_IMAGE_FEATURES:append = " verified-boot image-meta"
FW_ENV_CONFIG_FILE = "fw_env.config.64k"
FBVBOOT_GOLDEN_IMAGE_SIZE_MB = "64"
```

## meta-facebook/meta-grandteton/meta-inspirationpoint/conf/layer.conf
```bitbake
# We have a conf and classes directory, add to BBPATH
BBPATH .= ":${LAYERDIR}"

# We have recipes-* directories, add to BBFILES
BBFILES += "${LAYERDIR}/recipes-*/*/*.bb \
  ${LAYERDIR}/recipes-*/*/*.bbappend"

BBFILE_COLLECTIONS += "inspirationpoint"
BBFILE_PATTERN_inspirationpoint = "^${LAYERDIR}/"
BBFILE_PRIORITY_inspirationpoint = "25"

LAYERSERIES_COMPAT_inspirationpoint = "mickledore langdale kirkstone"
```

## meta-facebook/meta-grandteton/meta-inspirationpoint/conf/machine/inspirationpoint.conf
```bitbake
#@TYPE: Machine
#@NAME: Inspiration Point (Grand Teton Inference)
#@DESCRIPTION: Machine configuration for Facebook Grand Teton Inference platform

require conf/machine/include/ast2620.inc

KERNEL_IMAGETYPE = "zImage"
UBOOT_MACHINE:inspirationpoint = "facebook-grandteton_defconfig"
UBOOT_CONFIG_BASE = "fbobmc-ast-g6_defconfig"

KERNEL_DEVICETREE = "aspeed-bmc-facebook-inspirationpoint.dtb"
PREFERRED_VERSION_linux-aspeed = "5.10.%"

PREFERRED_VERSION_u-boot = "v2019.04%"
PREFERRED_VERSION_u-boot-tools = "v2019.04%"
PREFERRED_VERSION_u-boot-tools-native = "v2019.04%"
PREFERRED_VERSION_nativesdk-u-boot-tools = "v2019.04%"
PREFERRED_VERSION_u-boot-fw-utils = "v2019.04%"
PREFERRED_VERSION_u-boot-fw-utils-cross = "v2019.04%"
PREFERRED_VERSION_libretimer = "2.09"

PREFERRED_VERSION_libwatchdog = "0.2"

require conf/machine/include/fb-compute.inc
require conf/machine/include/mtd-ubifs.inc
require conf/machine/include/tpm2.inc

MACHINE_ESSENTIAL_EXTRA_RDEPENDS += "           \
    "

EXTRA_IMAGE_FEATURES:append = " verified-boot image-meta"
FW_ENV_CONFIG_FILE = "fw_env.config.64k"
FBVBOOT_GOLDEN_IMAGE_SIZE_MB = "64"
```

## meta-facebook/meta-greatlakes-lf/conf/layer.conf
```bitbake
# We have a conf and classes directory, add to BBPATH
BBPATH .= ":${LAYERDIR}"

# We have recipes-* directories, add to BBFILES
BBFILES += "${LAYERDIR}/recipes-*/*/*.bb \
	        ${LAYERDIR}/recipes-*/*/*.bbappend"

BBFILE_COLLECTIONS += "fb-greatlakes-layer"
BBFILE_PATTERN_fb-greatlakes-layer := "^${LAYERDIR}/"

LAYERSERIES_COMPAT_fb-greatlakes-layer = "mickledore kirkstone"
```

## meta-facebook/meta-greatlakes-lf/conf/machine/greatlakes-lf.conf
```bitbake
MACHINE = "greatlakes"

require conf/machine/greatlakes.conf

KERNEL_DEVICETREE = "aspeed-bmc-facebook-greatlakes.dtb"

UBOOT_DEVICETREE = "ast2600-greatlakes"
```

## meta-facebook/meta-greatlakes/conf/local.conf.sample
```bitbake
#
# Local configuration file for building the OpenBMC image.
#
MACHINE ??= "greatlakes"
DISTRO ?= "openbmc-fb-lf"
```

## meta-facebook/meta-harma/conf/layer.conf
```bitbake
# We have a conf and classes directory, add to BBPATH
BBPATH .= ":${LAYERDIR}"

# We have recipes-* directories, add to BBFILES
BBFILES += "${LAYERDIR}/recipes-*/*/*.bb \
            ${LAYERDIR}/recipes-*/*/*.bbappend"

BBFILE_COLLECTIONS += "fb-harma-layer"
BBFILE_PATTERN_fb-harma-layer := "^${LAYERDIR}/"

LAYERSERIES_COMPAT_fb-harma-layer := "scarthgap nanbield kirkstone"
```

## meta-facebook/meta-lightning/conf/layer.conf
```bitbake
# We have a conf and classes directory, add to BBPATH
BBPATH .= ":${LAYERDIR}"

# We have recipes-* directories, add to BBFILES
BBFILES += "${LAYERDIR}/recipes-*/*/*.bb \
	${LAYERDIR}/recipes-*/*/*.bbappend"

BBFILE_COLLECTIONS += "lightning"
BBFILE_PATTERN_lightning = "^${LAYERDIR}/"
BBFILE_PRIORITY_lightning = "20"

LAYERSERIES_COMPAT_lightning = "zeus warrior rocko"
```
